# nrf9120_mlm1_modem register map
Vendor: Nordic Semiconductor; Series: nrf91; File version: 1
Alta reference description for radio MCU with ARM 32-bit Cortex-M4 Microcontroller
CPU: CM4 r0p1, little endian, MPU, no FPU, 3 interrupt priority bits
Registers are 32-bit, read-write, reset 0x0 unless marked. A register's access mark holds for its fields unless they carry their own. Offsets are from the block's base; lines under a group give offsets from that group; [hi:lo] are bit positions; {n}, {i} and the like mark numbered series; 'fields as' and 'values as' point back to an identical list; <NAME> marks a mode.

## Memory map
0x00FF0000 FICR size 0x1000 — Factory Information Configuration Registers
0x00FF8000 UICR size 0x1000 — User Information Configuration Registers
0x40000000 AMLI size 0x1000 — AHB Multi-Layer Interface
0x40000000 DCNF size 0x1000 — Domain Configuration Management
0x40001000 MWU size 0x1000 — Memory Watch Unit
0x40010000 MCPLL size 0x1000 — Modem Clock PLL
0x40011000 BBDLL size 0x1000 — Base Band DLL
0x40012000 RCOSC32K size 0x1000 — 32.768 kHz RC oscillator
0x40015000 DCLOCK size 0x1000 — Clock Management
0x40015000 DPOWER size 0x1000 — Power Control
0x40021000 MODEMPERIPH size 0x1000 — Modem peripheral registers
0x40023000 UARTE size 0x1000 — UART with EasyDMA
0x40024000 MODEMTIMER0 size 0x1000 — Modem Timer/Counter 0
0x40025000 MODEMTIMER1 size 0x1000 — Modem Timer/Counter 1
0x40026000 RTC size 0x1000 — Real time counter
0x40027000 LWDT size 0x1000 — Watchdog Timer 0
0x40028000 SWDT size 0x1000 — Watchdog Timer 1
0x40029000 RNG size 0x1000 — Random Number Generator
0x4002A000 SIMIF size 0x1000 — SIM card interface
0x4002B000 IPC size 0x1000 — Inter Processor Communication
0x4002E000 M2M0 size 0x1000 — Memory to Memory DMA 0
0x4002F000 M2M1 size 0x1000 — Memory to Memory DMA 1
0x40030000 GPIOTE0 size 0x1000 — GPIO Tasks and Events 0
0x40031000 GPIOTE1 size 0x1000 — GPIO Tasks and Events 1
0x40032000 SECCONTROL size 0x1000 — Secure Control
0x40033000 TIMEMARKMUX size 0x1000 — Timemark multiplexer for LTE System Timer
0x40034000 P0 size 0x1000 — GPIO Port
0x40035000 TIMEREVENTSYNC size 0x1000 — Timer event synchronizer
0x40039000 TEMP size 0x1000 — Temperature Sensor
0x40040000 L2CIPHER size 0x1000 — L2 Cipher Registers
0x40042000 AESL2 size 0x1000 — AES-128 HW accelerator for LTE L2 security and MAC
0x40043000 SNOW size 0x1000 — Snow 3G Security IP
0x40044000 ZUC size 0x1000 — ZUC LTE L2 security IP
0x40050000 SHA size 0x1000 — SHA-1/SHA-256
0x40052000 DESCIPHER size 0x1000 — DES HW Accelerator
0x40060000 BPROT size 0x1000 — Block Protect
0x40060000 NVMC size 0x1000 — Non Volatile Memory Controller
0x40061000 VMC size 0x1000 — Volatile Memory controller
0xE0080000 TRACEANDDEBUG size 0x1000

## Interrupts
1 MWU
16 MCPLL
17 BBDLL
18 RCOSC32K
21 DCLOCK_DPOWER (DCLOCK, DPOWER)
35 UARTE
36 MODEMTIMER0
37 MODEMTIMER1
38 RTC
39 LWDT
40 SWDT
41 RNG
42 SIMIF
43 IPC
44 IPC1 (IPC)
45 IPC2 (IPC)
46 M2M0
47 M2M1
48 GPIOTE0
49 GPIOTE1
57 TEMP
66 AESL2
67 SNOW
68 ZUC
80 SHA
82 DESCIPHER

## Further device data
MaxInterrupts=240

## Licence text in the file
Copyright (c) 2016, Nordic Semiconductor ASA. All rights reserved. . Redistribution and use in source and binary forms, with or without modification, are permitted provided that the following conditions are met: * Redistributions of source code must retain the above copyright notice, this list of conditions and the following disclaimer. * Redistributions in binary form must reproduce the above copyright notice, this list of conditions and the following disclaimer in the documentation and/or other materials provided with the distribution. * Neither the name of Nordic Semiconductor ASA nor the names of its contributors may be used to endorse or promote products derived from this software without specific prior written permission. . THIS SOFTWARE IS PROVIDED BY THE COPYRIGHT HOLDERS AND CONTRIBUTORS "AS IS" AND ANY EXPRESS OR IMPLIED WARRANTIES, INCLUDING, BUT NOT LIMITED TO, THE. IMPLIED WARRANTIES OF MERCHANTABILITY AND FITNESS FOR A PARTICULAR PURPOSE ARE. DISCLAIMED. IN NO EVENT SHALL THE COPYRIGHT HOLDER OR CONTRIBUTORS BE LIABLE. FOR ANY DIRECT, INDIRECT, INCIDENTAL, SPECIAL, EXEMPLARY, OR CONSEQUENTIAL. DAMAGES (INCLUDING, BUT NOT LIMITED TO, PROCUREMENT OF SUBSTITUTE GOODS OR. SERVICES; LOSS OF USE, DATA, OR PROFITS; OR BUSINESS INTERRUPTION) HOWEVER. CAUSED AND ON ANY THEORY OF LIABILITY, WHETHER IN CONTRACT, STRICT LIABILITY, OR TORT (INCLUDING NEGLIGENCE OR OTHERWISE) ARISING IN ANY WAY OUT OF THE USE. OF THIS SOFTWARE, EVEN IF ADVISED OF THE POSSIBILITY OF SUCH DAMAGE.
