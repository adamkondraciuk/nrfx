# haltium_sysctrl register map
Vendor: Nordic Semiconductor; Series: nRFHaltium; File version: 1
nRFHaltium reference description for system-on-chip with many ARM 32-bit Cortex-M33 microcontrollers
Registers are 32-bit, read-write, reset 0x0 unless marked. A register's access mark holds for its fields unless they carry their own. Offsets are from the block's base; lines under a group give offsets from that group; [hi:lo] are bit positions; {n}, {i} and the like mark numbered series; 'fields as' and 'values as' point back to an identical list; <NAME> marks a mode.

## Memory map
0x0FFFE000 GLOBAL_FICR_NS size 0x4000 — Factory Information Configuration Registers
0x2F700000 GLOBAL_USBHSCORE0_NS size 0x24000 — USBHSCORE 0
0x2F700000 GLOBAL_USBHSCORE0_S size 0x24000 — USBHSCORE 1
0x2F840000 OICR_S size 0x4000 — One time programmable Information Configuration Registers
0x2FBE0000 GLOBAL_I3CCORE120_NS size 0x1000 — I3CCORE 0
0x2FBE1000 GLOBAL_I3CCORE121_NS size 0x1000 — I3CCORE 1
0x3F640000 L2CACHEDATA_S size 0x1000 — CACHEDATA
0x3F680000 L2CACHEINFO_S size 0x1000 — CACHEINFO
0x4F095000 GLOBAL_EXMIF_NS size 0x1000 — External Memory Interface 0
0x4F8D1000 GLOBAL_IPCT120_NS size 0x1000 — IPCT APB registers 0
0x4F8D2000 GLOBAL_MUTEX120_NS size 0x1000 — MUTEX 0
0x4F8D3000 GLOBAL_I3C120_NS size 0x1000 — I3C 0
0x4F8D4000 GLOBAL_VPR121_NS size 0x1000 — VPR peripheral registers 1
0x4F8D8000 GLOBAL_CAN_NS size 0x1000 — Controller Area Network 0
0x4F8DE000 GLOBAL_I3C121_NS size 0x1000 — I3C 2
0x4F8E1000 GLOBAL_DPPIC120_NS size 0x1000 — Distributed programmable peripheral interconnect controller 0
0x4F8E2000 GLOBAL_TIMER120_NS size 0x1000 — Timer/Counter 0
0x4F8E3000 GLOBAL_TIMER121_NS size 0x1000 — Timer/Counter 2
0x4F8E4000 GLOBAL_PWM120_NS size 0x1000 — Pulse width modulation unit 0
0x4F8E5000 GLOBAL_SPIS120_NS size 0x1000 — SPI Slave 0
0x4F8E5000 GLOBAL_UARTE120_NS size 0x1000 — UART with EasyDMA 0
0x4F8E6000 GLOBAL_SPIM120_NS size 0x1000 — Serial Peripheral Interface Master with EasyDMA 0
0x4F8E7000 GLOBAL_SPIM121_NS size 0x1000 — Serial Peripheral Interface Master with EasyDMA 2
0x4F8E8000 GLOBAL_TWIM120_NS size 0x1000 — I2C compatible Two-Wire Master Interface with EasyDMA 0
0x4F908000 GLOBAL_VPR130_NS size 0x1000 — VPR peripheral registers 3
0x4F921000 GLOBAL_IPCT130_NS size 0x1000 — IPCT APB registers 2
0x4F922000 GLOBAL_DPPIC130_NS size 0x1000 — Distributed programmable peripheral interconnect controller 2
0x4F927000 GLOBAL_MUTEX130_NS size 0x1000 — MUTEX 1
0x4F928000 GLOBAL_RTC130_NS size 0x1000 — Real-time counter 0
0x4F929000 GLOBAL_RTC131_NS size 0x1000 — Real-time counter 2
0x4F92B000 GLOBAL_WDT131_NS size 0x1000 — Watchdog Timer 1
0x4F92C000 GLOBAL_WDT132_NS size 0x1000 — Watchdog Timer 3
0x4F92D000 GLOBAL_EGU130_NS size 0x1000 — Event generator unit 0
0x4F934000 GLOBAL_GPIOTE130_NS size 0x1000 — GPIO Tasks and Events 0
0x4F935000 GLOBAL_GPIOTE131_NS size 0x1000 — GPIO Tasks and Events 2
{0x4F938000+0x200*n} GLOBAL_P{n}_NS size 0x200 (n=0..7) — GPIO Port {n}
{0x4F938000+0x200*n} GLOBAL_P{n}_NS size 0x200 (n=8..15) — GPIO Port {n+8}
0x4F939E00 GLOBAL_GPIOINTERNAL_NS size 0x2000 — GPIO Internal 0
0x4F981000 GLOBAL_DPPIC131_NS size 0x1000 — Distributed programmable peripheral interconnect controller 4
0x4F982000 GLOBAL_SAADC_NS size 0x1000 — Analog to Digital Converter 0
0x4F983000 GLOBAL_COMP_NS size 0x1000 — Comparator 0
0x4F983000 GLOBAL_LPCOMP_NS size 0x1000 — Low-power comparator 0
0x4F984000 GLOBAL_TEMP_NS size 0x1000 — Temperature Sensor 0
0x4F985000 GLOBAL_NFCT_NS size 0x1000 — NFC-A compatible radio NFC-A compatible radio 0
0x4F991000 GLOBAL_DPPIC132_NS size 0x1000 — Distributed programmable peripheral interconnect controller 6
0x4F992000 GLOBAL_I2S130_NS size 0x1000 — Inter-IC Sound 0
0x4F993000 GLOBAL_PDM_NS size 0x1000 — Pulse Density Modulation (Digital Microphone) Interface 0
0x4F994000 GLOBAL_QDEC130_NS size 0x1000 — Quadrature Decoder 0
0x4F995000 GLOBAL_QDEC131_NS size 0x1000 — Quadrature Decoder 2
0x4F996000 GLOBAL_SIMIF_NS size 0x1000 — SIM card interface 0
0x4F997000 GLOBAL_I2S131_NS size 0x1000 — Inter-IC Sound 2
0x4F99B000 GLOBAL_MIPIRFFE_NS size 0x1000 — MipiRffe Master 0
0x4F99C000 GLOBAL_GRTC_NS size 0x1000 — Global Real-time counter 0
0x4F9A1000 GLOBAL_DPPIC133_NS size 0x1000 — Distributed programmable peripheral interconnect controller 8
0x4F9A2000 GLOBAL_TIMER130_NS size 0x1000 — Timer/Counter 4
0x4F9A3000 GLOBAL_TIMER131_NS size 0x1000 — Timer/Counter 6
0x4F9A4000 GLOBAL_PWM130_NS size 0x1000 — Pulse width modulation unit 2
0x4F9A5000 GLOBAL_SPIM130_NS size 0x1000 — Serial Peripheral Interface Master with EasyDMA 4
0x4F9A5000 GLOBAL_SPIS130_NS size 0x1000 — SPI Slave 2
0x4F9A5000 GLOBAL_TWIM130_NS size 0x1000 — I2C compatible Two-Wire Master Interface with EasyDMA 2
0x4F9A5000 GLOBAL_TWIS130_NS size 0x1000 — I2C compatible Two-Wire Slave Interface with EasyDMA 0
0x4F9A5000 GLOBAL_UARTE130_NS size 0x1000 — UART with EasyDMA 2
0x4F9A6000 GLOBAL_SPIM131_NS size 0x1000 — Serial Peripheral Interface Master with EasyDMA 6
0x4F9A6000 GLOBAL_SPIS131_NS size 0x1000 — SPI Slave 4
0x4F9A6000 GLOBAL_TWIM131_NS size 0x1000 — I2C compatible Two-Wire Master Interface with EasyDMA 4
0x4F9A6000 GLOBAL_TWIS131_NS size 0x1000 — I2C compatible Two-Wire Slave Interface with EasyDMA 2
0x4F9A6000 GLOBAL_UARTE131_NS size 0x1000 — UART with EasyDMA 4
0x4F9B1000 GLOBAL_DPPIC134_NS size 0x1000 — Distributed programmable peripheral interconnect controller 10
0x4F9B2000 GLOBAL_TIMER132_NS size 0x1000 — Timer/Counter 8
0x4F9B3000 GLOBAL_TIMER133_NS size 0x1000 — Timer/Counter 10
0x4F9B4000 GLOBAL_PWM131_NS size 0x1000 — Pulse width modulation unit 4
0x4F9B5000 GLOBAL_SPIM132_NS size 0x1000 — Serial Peripheral Interface Master with EasyDMA 8
0x4F9B5000 GLOBAL_SPIS132_NS size 0x1000 — SPI Slave 6
0x4F9B5000 GLOBAL_TWIM132_NS size 0x1000 — I2C compatible Two-Wire Master Interface with EasyDMA 6
0x4F9B5000 GLOBAL_TWIS132_NS size 0x1000 — I2C compatible Two-Wire Slave Interface with EasyDMA 4
0x4F9B5000 GLOBAL_UARTE132_NS size 0x1000 — UART with EasyDMA 6
0x4F9B6000 GLOBAL_SPIM133_NS size 0x1000 — Serial Peripheral Interface Master with EasyDMA 10
0x4F9B6000 GLOBAL_SPIS133_NS size 0x1000 — SPI Slave 8
0x4F9B6000 GLOBAL_TWIM133_NS size 0x1000 — I2C compatible Two-Wire Master Interface with EasyDMA 8
0x4F9B6000 GLOBAL_TWIS133_NS size 0x1000 — I2C compatible Two-Wire Slave Interface with EasyDMA 6
0x4F9B6000 GLOBAL_UARTE133_NS size 0x1000 — UART with EasyDMA 8
0x4F9C1000 GLOBAL_DPPIC135_NS size 0x1000 — Distributed programmable peripheral interconnect controller 12
0x4F9C2000 GLOBAL_TIMER134_NS size 0x1000 — Timer/Counter 12
0x4F9C3000 GLOBAL_TIMER135_NS size 0x1000 — Timer/Counter 14
0x4F9C4000 GLOBAL_PWM132_NS size 0x1000 — Pulse width modulation unit 6
0x4F9C5000 GLOBAL_SPIM134_NS size 0x1000 — Serial Peripheral Interface Master with EasyDMA 12
0x4F9C5000 GLOBAL_SPIS134_NS size 0x1000 — SPI Slave 10
0x4F9C5000 GLOBAL_TWIM134_NS size 0x1000 — I2C compatible Two-Wire Master Interface with EasyDMA 10
0x4F9C5000 GLOBAL_TWIS134_NS size 0x1000 — I2C compatible Two-Wire Slave Interface with EasyDMA 8
0x4F9C5000 GLOBAL_UARTE134_NS size 0x1000 — UART with EasyDMA 10
0x4F9C6000 GLOBAL_SPIM135_NS size 0x1000 — Serial Peripheral Interface Master with EasyDMA 14
0x4F9C6000 GLOBAL_SPIS135_NS size 0x1000 — SPI Slave 12
0x4F9C6000 GLOBAL_TWIM135_NS size 0x1000 — I2C compatible Two-Wire Master Interface with EasyDMA 12
0x4F9C6000 GLOBAL_TWIS135_NS size 0x1000 — I2C compatible Two-Wire Slave Interface with EasyDMA 10
0x4F9C6000 GLOBAL_UARTE135_NS size 0x1000 — UART with EasyDMA 12
0x4F9D1000 GLOBAL_DPPIC136_NS size 0x1000 — Distributed programmable peripheral interconnect controller 14
0x4F9D2000 GLOBAL_TIMER136_NS size 0x1000 — Timer/Counter 16
0x4F9D3000 GLOBAL_TIMER137_NS size 0x1000 — Timer/Counter 18
0x4F9D4000 GLOBAL_PWM133_NS size 0x1000 — Pulse width modulation unit 8
0x4F9D5000 GLOBAL_SPIM136_NS size 0x1000 — Serial Peripheral Interface Master with EasyDMA 16
0x4F9D5000 GLOBAL_SPIS136_NS size 0x1000 — SPI Slave 14
0x4F9D5000 GLOBAL_TWIM136_NS size 0x1000 — I2C compatible Two-Wire Master Interface with EasyDMA 14
0x4F9D5000 GLOBAL_TWIS136_NS size 0x1000 — I2C compatible Two-Wire Slave Interface with EasyDMA 12
0x4F9D5000 GLOBAL_UARTE136_NS size 0x1000 — UART with EasyDMA 14
0x4F9D6000 GLOBAL_SPIM137_NS size 0x1000 — Serial Peripheral Interface Master with EasyDMA 18
0x4F9D6000 GLOBAL_SPIS137_NS size 0x1000 — SPI Slave 16
0x4F9D6000 GLOBAL_TWIM137_NS size 0x1000 — I2C compatible Two-Wire Master Interface with EasyDMA 16
0x4F9D6000 GLOBAL_TWIS137_NS size 0x1000 — I2C compatible Two-Wire Slave Interface with EasyDMA 14
0x4F9D6000 GLOBAL_UARTE137_NS size 0x1000 — UART with EasyDMA 16
0x5F082000 L2CACHE_S size 0x1000 — Cache
0x5F083000 RAMC110_S size 0x1000 — RAM Controller 0
0x5F084000 RAMC111_S size 0x1000 — RAM Controller 1
0x5F086000 GLOBAL_USBHS_NS size 0x1000 — USBHS 0
0x5F086000 GLOBAL_USBHS_S size 0x1000 — USBHS 1
0x5F088000 SHA3_S size 0x1000 — CRACEN
0x5F089000 SHA3CORE_S size 0x1000 — CRACENCORE
0x5F08A000 RAMC112_S size 0x1000 — RAM Controller 2
0x5F08B000 RAMC113_S size 0x1000 — RAM Controller 3
0x5F08E000 PCGCS110_S size 0x1000 — PCGCSlave 0
0x5F08F000 PCGCM110_S size 0x1000 — PCGC Master 0
0x5F092000 GLOBAL_MRAMC110_S size 0x1000 — MRAM controller 0
0x5F093000 GLOBAL_MRAMC111_S size 0x1000 — MRAM controller 1
0x5F094000 EXMEE_S size 0x1000 — EXternal Memory Encryption Engine
0x5F095000 GLOBAL_EXMIF_S size 0x1000 — External Memory Interface 1
0x5F097000 MVDMA_S size 0x1000 — MVDMA performs direct-memory-accesses between memories. Data is transferred according to job descriptor lists. Each transfer has corresponding source and sink descriptor lists with matching data amounts. The lists are in memory and they contain data buffer information, address pointers, buffer sizes and data type attributes.
0x5F098000 PPIB110_S size 0x1000 — PPIB APB registers 0
0x5F8C2000 GLOBAL_CANPLLPM_NS size 0x1000 — AUXPM 0
0x5F8C2000 GLOBAL_CANPLLPM_S size 0x1000 — AUXPM 1
0x5F8C2000 GLOBAL_CANPLL_NS size 0x1000 — AUXPLL 0
0x5F8C2000 GLOBAL_CANPLL_S size 0x1000 — AUXPLL 1
0x5F8C3000 RAMC120_S size 0x1000 — RAM Controller 4
0x5F8C4000 RAMC121_S size 0x1000 — RAM Controller 5
0x5F8C5000 GLOBAL_OTPC_S size 0x1000 — OTP controller
0x5F8C6000 ROMC_S size 0x1000 — ROM Controller
0x5F8C7000 MEMCONF120_S size 0x1000 — Memory configuration 0
0x5F8C8000 VPR_S size 0x4000 — VPR CLIC registers
0x5F8C8000 GLOBAL_VPR120_S size 0x1000 — VPR peripheral registers 0
0x5F8CC000 HSFLL121_S size 0x1000 — HSFLL 1
0x5F8CD000 HSFLL120_S size 0x1000 — HSFLL 2
0x5F8CE000 LRCCONF120_S size 0x1000 — LRCCONF 1
0x5F8CF000 PCGCM120_S size 0x1000 — PCGC Master 1
0x5F8D1000 GLOBAL_IPCT120_S size 0x1000 — IPCT APB registers 1
0x5F8D3000 GLOBAL_I3C120_S size 0x1000 — I3C 1
0x5F8D4000 GLOBAL_VPR121_S size 0x1000 — VPR peripheral registers 2
0x5F8D8000 GLOBAL_CAN_S size 0x1000 — Controller Area Network 1
0x5F8DE000 GLOBAL_I3C121_S size 0x1000 — I3C 3
0x5F8E1000 GLOBAL_DPPIC120_S size 0x1000 — Distributed programmable peripheral interconnect controller 1
0x5F8E2000 GLOBAL_TIMER120_S size 0x1000 — Timer/Counter 1
0x5F8E3000 GLOBAL_TIMER121_S size 0x1000 — Timer/Counter 3
0x5F8E4000 GLOBAL_PWM120_S size 0x1000 — Pulse width modulation unit 1
0x5F8E5000 GLOBAL_SPIS120_S size 0x1000 — SPI Slave 1
0x5F8E5000 GLOBAL_UARTE120_S size 0x1000 — UART with EasyDMA 1
0x5F8E6000 GLOBAL_SPIM120_S size 0x1000 — Serial Peripheral Interface Master with EasyDMA 1
0x5F8E7000 GLOBAL_SPIM121_S size 0x1000 — Serial Peripheral Interface Master with EasyDMA 3
0x5F8E8000 GLOBAL_TWIM120_S size 0x1000 — I2C compatible Two-Wire Master Interface with EasyDMA 1
0x5F8EA000 PCGCS120_S size 0x1000 — PCGCSlave 1
0x5F8EB000 PCGCS121_S size 0x1000 — PCGCSlave 2
0x5F8EC000 PCGCS122_S size 0x1000 — PCGCSlave 3
0x5F8ED000 PCGCM121_S size 0x1000 — PCGC Master 2
0x5F8EE000 PPIB120_S size 0x1000 — PPIB APB registers 1
0x5F8EF000 PPIB121_S size 0x1000 — PPIB APB registers 2
0x5F903000 RAMC130_S size 0x1000 — RAM Controller 6
0x5F904000 RAMC131_S size 0x1000 — RAM Controller 7
0x5F905000 MEMCONF130_S size 0x1000 — Memory configuration 1
0x5F908000 GLOBAL_VPR130_S size 0x1000 — VPR peripheral registers 4
0x5F90E000 PCGCS130_S size 0x1000 — PCGCSlave 4
0x5F921000 GLOBAL_IPCT130_S size 0x1000 — IPCT APB registers 3
0x5F922000 GLOBAL_DPPIC130_S size 0x1000 — Distributed programmable peripheral interconnect controller 3
0x5F925000 PPIB130_S size 0x1000 — PPIB APB registers 3
0x5F926000 PPIB131_S size 0x1000 — PPIB APB registers 4
0x5F928000 GLOBAL_RTC130_S size 0x1000 — Real-time counter 1
0x5F929000 GLOBAL_RTC131_S size 0x1000 — Real-time counter 3
0x5F92A000 WDT130_S size 0x1000 — Watchdog Timer 0
0x5F92B000 GLOBAL_WDT131_S size 0x1000 — Watchdog Timer 2
0x5F92C000 GLOBAL_WDT132_S size 0x1000 — Watchdog Timer 4
0x5F92D000 GLOBAL_EGU130_S size 0x1000 — Event generator unit 1
0x5F934000 GLOBAL_GPIOTE130_S size 0x1000 — GPIO Tasks and Events 1
0x5F935000 GLOBAL_GPIOTE131_S size 0x1000 — GPIO Tasks and Events 3
{0x5F938000+0x200*n} GLOBAL_P{n}_S size 0x200 (n=0..7) — GPIO Port {n+8}
{0x5F938000+0x200*n} GLOBAL_P{n}_S size 0x200 (n=8..15) — GPIO Port {n+16}
0x5F939E00 GLOBAL_GPIOINTERNAL_S size 0x2000 — GPIO Internal 1
0x5F93C000 PCGCS131_S size 0x1000 — PCGCSlave 5
0x5F93D000 PCGCM130_S size 0x1000 — PCGC Master 3
0x5F93E000 LRCCONF130_S size 0x1000 — LRCCONF 2
0x5F93F000 PCGCM131_S size 0x1000 — PCGC Master 4
0x5F940000 GRCCONF_S size 0x1000 — GRCCONF
0x5F943000 PCRM_S size 0x1000 — PCRM
0x5F949000 RESETHUB_S size 0x1000 — Reset hub
0x5F94E000 PCGCS132_S size 0x1000 — PCGCSlave 6
0x5F94F000 PCGCM132_S size 0x1000 — PCGC Master 5
0x5F950000 CLOCK_S size 0x1000 — CLOCK
0x5F951000 LFRC_S size 0x1000 — LFRC peripheral
0x5F952000 GGENERIC18_S size 0x1000 — GENERIC
0x5F953000 LFXO_S size 0x1000 — LFXO peripheral
0x5F954000 FLL16M_S size 0x1000 — FLL16M
0x5F955000 HFXO_S size 0x1000 — HFXO peripheral
0x5F957000 AUDIOPLL_S size 0x1000 — AUXPLL 0
0x5F958000 USBHSPLL_S size 0x1000 — AUXPLL 1
0x5F960000 POWER_S size 0x1000 — POWER
0x5F961000 VREGMAIN_S size 0x1000 — VREGMAIN peripheral
0x5F962000 VREGAO1V8_S size 0x1000 — VREGAO1V8 peripheral
0x5F963000 VREG1V0_S size 0x1000 — VREG1V0
0x5F964000 VREGAO0V8_S size 0x1000 — VREGAO0V8 peripheral
0x5F965000 VREGVS0V8_S size 0x1000 — VREGVS0V8 peripheral
0x5F966000 VREGSU_S size 0x1000 — VREGSU peripheral
0x5F967000 VREGUSB_S size 0x1000 — VREGUSB peripheral
0x5F968000 AUDIOPLLPM_S size 0x1000 — AUXPM
0x5F969000 VREGMRAM130_S size 0x1000 — VREGMRAM peripheral 0
0x5F96A000 VREGMRAM131_S size 0x1000 — VREGMRAM peripheral 1
0x5F96B000 OSCRFR_S size 0x1000 — OSCRFR peripheral
0x5F96C000 SWEXT_S size 0x1000 — SWEXT peripheral
0x5F96D000 MBIAS_S size 0x1000 — MBIAS peripheral
0x5F970000 VDETAO1V8_S size 0x1000 — VDETAO1V8 peripheral
0x5F971000 VDETAO0V8_S size 0x1000 — VDETAO0V8 peripheral
0x5F972000 VDETVS0V8_S size 0x1000 — VDETVS0V8 peripheral
0x5F974000 VDETIO_S size 0x1000 — VDETIO peripheral
0x5F975000 VDETAO5V0_S size 0x1000 — VDETAO5V0 peripheral
0x5F976000 VDET1V0_S size 0x1000 — VDET1V0 peripheral
0x5F981000 GLOBAL_DPPIC131_S size 0x1000 — Distributed programmable peripheral interconnect controller 5
0x5F982000 GLOBAL_SAADC_S size 0x1000 — Analog to Digital Converter 1
0x5F983000 GLOBAL_COMP_S size 0x1000 — Comparator 1
0x5F983000 GLOBAL_LPCOMP_S size 0x1000 — Low-power comparator 1
0x5F984000 GLOBAL_TEMP_S size 0x1000 — Temperature Sensor 1
0x5F985000 GLOBAL_NFCT_S size 0x1000 — NFC-A compatible radio NFC-A compatible radio 1
0x5F98D000 PPIB132_S size 0x1000 — PPIB APB registers 5
0x5F98E000 PCGCS133_S size 0x1000 — PCGCSlave 7
0x5F98F000 PCGCM133_S size 0x1000 — PCGC Master 6
0x5F991000 GLOBAL_DPPIC132_S size 0x1000 — Distributed programmable peripheral interconnect controller 7
0x5F992000 GLOBAL_I2S130_S size 0x1000 — Inter-IC Sound 1
0x5F993000 GLOBAL_PDM_S size 0x1000 — Pulse Density Modulation (Digital Microphone) Interface 1
0x5F994000 GLOBAL_QDEC130_S size 0x1000 — Quadrature Decoder 1
0x5F995000 GLOBAL_QDEC131_S size 0x1000 — Quadrature Decoder 3
0x5F996000 GLOBAL_SIMIF_S size 0x1000 — SIM card interface 1
0x5F997000 GLOBAL_I2S131_S size 0x1000 — Inter-IC Sound 3
0x5F99B000 GLOBAL_MIPIRFFE_S size 0x1000 — MipiRffe Master 1
0x5F99C000 GLOBAL_GRTC_S size 0x1000 — Global Real-time counter 1
0x5F99D000 PPIB133_S size 0x1000 — PPIB APB registers 6
0x5F99E000 PCGCS134_S size 0x1000 — PCGCSlave 8
0x5F99F000 PCGCM134_S size 0x1000 — PCGC Master 7
0x5F9A1000 GLOBAL_DPPIC133_S size 0x1000 — Distributed programmable peripheral interconnect controller 9
0x5F9A2000 GLOBAL_TIMER130_S size 0x1000 — Timer/Counter 5
0x5F9A3000 GLOBAL_TIMER131_S size 0x1000 — Timer/Counter 7
0x5F9A4000 GLOBAL_PWM130_S size 0x1000 — Pulse width modulation unit 3
0x5F9A5000 GLOBAL_SPIM130_S size 0x1000 — Serial Peripheral Interface Master with EasyDMA 5
0x5F9A5000 GLOBAL_SPIS130_S size 0x1000 — SPI Slave 3
0x5F9A5000 GLOBAL_TWIM130_S size 0x1000 — I2C compatible Two-Wire Master Interface with EasyDMA 3
0x5F9A5000 GLOBAL_TWIS130_S size 0x1000 — I2C compatible Two-Wire Slave Interface with EasyDMA 1
0x5F9A5000 GLOBAL_UARTE130_S size 0x1000 — UART with EasyDMA 3
0x5F9A6000 GLOBAL_SPIM131_S size 0x1000 — Serial Peripheral Interface Master with EasyDMA 7
0x5F9A6000 GLOBAL_SPIS131_S size 0x1000 — SPI Slave 5
0x5F9A6000 GLOBAL_TWIM131_S size 0x1000 — I2C compatible Two-Wire Master Interface with EasyDMA 5
0x5F9A6000 GLOBAL_TWIS131_S size 0x1000 — I2C compatible Two-Wire Slave Interface with EasyDMA 3
0x5F9A6000 GLOBAL_UARTE131_S size 0x1000 — UART with EasyDMA 5
0x5F9AD000 PPIB134_S size 0x1000 — PPIB APB registers 7
0x5F9AE000 PCGCS135_S size 0x1000 — PCGCSlave 9
0x5F9AF000 PCGCM135_S size 0x1000 — PCGC Master 8
0x5F9B1000 GLOBAL_DPPIC134_S size 0x1000 — Distributed programmable peripheral interconnect controller 11
0x5F9B2000 GLOBAL_TIMER132_S size 0x1000 — Timer/Counter 9
0x5F9B3000 GLOBAL_TIMER133_S size 0x1000 — Timer/Counter 11
0x5F9B4000 GLOBAL_PWM131_S size 0x1000 — Pulse width modulation unit 5
0x5F9B5000 GLOBAL_SPIM132_S size 0x1000 — Serial Peripheral Interface Master with EasyDMA 9
0x5F9B5000 GLOBAL_SPIS132_S size 0x1000 — SPI Slave 7
0x5F9B5000 GLOBAL_TWIM132_S size 0x1000 — I2C compatible Two-Wire Master Interface with EasyDMA 7
0x5F9B5000 GLOBAL_TWIS132_S size 0x1000 — I2C compatible Two-Wire Slave Interface with EasyDMA 5
0x5F9B5000 GLOBAL_UARTE132_S size 0x1000 — UART with EasyDMA 7
0x5F9B6000 GLOBAL_SPIM133_S size 0x1000 — Serial Peripheral Interface Master with EasyDMA 11
0x5F9B6000 GLOBAL_SPIS133_S size 0x1000 — SPI Slave 9
0x5F9B6000 GLOBAL_TWIM133_S size 0x1000 — I2C compatible Two-Wire Master Interface with EasyDMA 9
0x5F9B6000 GLOBAL_TWIS133_S size 0x1000 — I2C compatible Two-Wire Slave Interface with EasyDMA 7
0x5F9B6000 GLOBAL_UARTE133_S size 0x1000 — UART with EasyDMA 9
0x5F9BD000 PPIB135_S size 0x1000 — PPIB APB registers 8
0x5F9BE000 PCGCS136_S size 0x1000 — PCGCSlave 10
0x5F9BF000 PCGCM136_S size 0x1000 — PCGC Master 9
0x5F9C1000 GLOBAL_DPPIC135_S size 0x1000 — Distributed programmable peripheral interconnect controller 13
0x5F9C2000 GLOBAL_TIMER134_S size 0x1000 — Timer/Counter 13
0x5F9C3000 GLOBAL_TIMER135_S size 0x1000 — Timer/Counter 15
0x5F9C4000 GLOBAL_PWM132_S size 0x1000 — Pulse width modulation unit 7
0x5F9C5000 GLOBAL_SPIM134_S size 0x1000 — Serial Peripheral Interface Master with EasyDMA 13
0x5F9C5000 GLOBAL_SPIS134_S size 0x1000 — SPI Slave 11
0x5F9C5000 GLOBAL_TWIM134_S size 0x1000 — I2C compatible Two-Wire Master Interface with EasyDMA 11
0x5F9C5000 GLOBAL_TWIS134_S size 0x1000 — I2C compatible Two-Wire Slave Interface with EasyDMA 9
0x5F9C5000 GLOBAL_UARTE134_S size 0x1000 — UART with EasyDMA 11
0x5F9C6000 GLOBAL_SPIM135_S size 0x1000 — Serial Peripheral Interface Master with EasyDMA 15
0x5F9C6000 GLOBAL_SPIS135_S size 0x1000 — SPI Slave 13
0x5F9C6000 GLOBAL_TWIM135_S size 0x1000 — I2C compatible Two-Wire Master Interface with EasyDMA 13
0x5F9C6000 GLOBAL_TWIS135_S size 0x1000 — I2C compatible Two-Wire Slave Interface with EasyDMA 11
0x5F9C6000 GLOBAL_UARTE135_S size 0x1000 — UART with EasyDMA 13
0x5F9CD000 PPIB136_S size 0x1000 — PPIB APB registers 9
0x5F9CE000 PCGCS137_S size 0x1000 — PCGCSlave 11
0x5F9CF000 PCGCM137_S size 0x1000 — PCGC Master 10
0x5F9D1000 GLOBAL_DPPIC136_S size 0x1000 — Distributed programmable peripheral interconnect controller 15
0x5F9D2000 GLOBAL_TIMER136_S size 0x1000 — Timer/Counter 17
0x5F9D3000 GLOBAL_TIMER137_S size 0x1000 — Timer/Counter 19
0x5F9D4000 GLOBAL_PWM133_S size 0x1000 — Pulse width modulation unit 9
0x5F9D5000 GLOBAL_SPIM136_S size 0x1000 — Serial Peripheral Interface Master with EasyDMA 17
0x5F9D5000 GLOBAL_SPIS136_S size 0x1000 — SPI Slave 15
0x5F9D5000 GLOBAL_TWIM136_S size 0x1000 — I2C compatible Two-Wire Master Interface with EasyDMA 15
0x5F9D5000 GLOBAL_TWIS136_S size 0x1000 — I2C compatible Two-Wire Slave Interface with EasyDMA 13
0x5F9D5000 GLOBAL_UARTE136_S size 0x1000 — UART with EasyDMA 15
0x5F9D6000 GLOBAL_SPIM137_S size 0x1000 — Serial Peripheral Interface Master with EasyDMA 19
0x5F9D6000 GLOBAL_SPIS137_S size 0x1000 — SPI Slave 17
0x5F9D6000 GLOBAL_TWIM137_S size 0x1000 — I2C compatible Two-Wire Master Interface with EasyDMA 17
0x5F9D6000 GLOBAL_TWIS137_S size 0x1000 — I2C compatible Two-Wire Slave Interface with EasyDMA 15
0x5F9D6000 GLOBAL_UARTE137_S size 0x1000 — UART with EasyDMA 17
0x5F9DD000 PPIB137_S size 0x1000 — PPIB APB registers 10
0x5F9DE000 PCGCS138_S size 0x1000 — PCGCSlave 12
0x5F9DF000 PCGCM138_S size 0x1000 — PCGC Master 11
0xA0000000 GLOBAL_STMDATA_NS size 0x10000000 — System Trace Macrocell data buffer 0
0xA0000000 GLOBAL_STMDATA_S size 0x10000000 — System Trace Macrocell data buffer 1
0xBF001000 GLOBAL_TDDCONF_NS size 0x1000 — TDDCONF 0
0xBF001000 GLOBAL_TDDCONF_S size 0x1000 — TDDCONF 1
0xBF003000 GLOBAL_TBM_NS size 0x1000 — Trace buffer monitor 0
0xBF003000 GLOBAL_TBM_S size 0x1000 — Trace buffer monitor 1
0xBF004000 HSFLL200_S size 0x1000 — HSFLL 0
0xBF005000 LRCCONF200_S size 0x1000 — LRCCONF 0
0xBF041000 GLOBAL_TSGEN_NS size 0x1000 — GENERIC
0xBF042000 GLOBAL_STM_NS size 0x1000 — System Trace Macrocell
0xBF043000 GLOBAL_TPIU_NS size 0x1000 — Trace Port Interface Unit
0xBF044000 GLOBAL_ETB_NS size 0x1000 — GENERIC
0xBF045000 GLOBAL_ETR_NS size 0x1000 — GENERIC
0xBF046000 GLOBAL_CTI210_NS size 0x1000 — Cross-Trigger Interface control 0
0xBF047000 GLOBAL_CTI211_NS size 0x1000 — Cross-Trigger Interface control 1
0xBF048000 GLOBAL_ATBREPLICATOR210_NS size 0x1000 — ATB Replicator module 0
0xBF049000 GLOBAL_ATBREPLICATOR211_NS size 0x1000 — ATB Replicator module 1
0xBF04A000 GLOBAL_ATBREPLICATOR212_NS size 0x1000 — ATB Replicator module 2
0xBF04B000 GLOBAL_ATBREPLICATOR213_NS size 0x1000 — ATB Replicator module 3
0xBF04C000 GLOBAL_ATBFUNNEL210_NS size 0x1000 — ATB funnel module 0
0xBF04D000 GLOBAL_ATBFUNNEL211_NS size 0x1000 — ATB funnel module 1
0xBF04E000 GLOBAL_ATBFUNNEL212_NS size 0x1000 — ATB funnel module 2
0xBF04F000 GLOBAL_ATBFUNNEL213_NS size 0x1000 — ATB funnel module 3

## Interrupts
{n} VPR0_{n} (VPR_S) (n=0..31)
104 GPIOTE130_0 (GLOBAL_GPIOTE130_NS, GLOBAL_GPIOTE130_S)
105 GPIOTE130_1 (GLOBAL_GPIOTE130_NS, GLOBAL_GPIOTE130_S)
106 GPIOTE131_0 (GLOBAL_GPIOTE131_NS, GLOBAL_GPIOTE131_S)
107 GPIOTE1310_1 (GLOBAL_GPIOTE131_NS, GLOBAL_GPIOTE131_S)
108 GRTC0_0 (GLOBAL_GRTC_NS, GLOBAL_GRTC_S)
109 GRTC0_1 (GLOBAL_GRTC_NS, GLOBAL_GRTC_S)
127 TBM (GLOBAL_TBM_NS, GLOBAL_TBM_S)
130 L2CACHE (L2CACHE_S)
134 USBHS (GLOBAL_USBHS_NS, GLOBAL_USBHS_S)
136 SHA3 (SHA3_S)
146 MRAMC110 (GLOBAL_MRAMC110_S)
147 MRAMC111 (GLOBAL_MRAMC111_S)
148 EXMEE (EXMEE_S)
149 EXMIF (GLOBAL_EXMIF_NS, GLOBAL_EXMIF_S)
151 MVDMA (MVDMA_S)
194 CANPLL_CANPLLPM (GLOBAL_CANPLLPM_NS, GLOBAL_CANPLLPM_S, GLOBAL_CANPLL_NS, GLOBAL_CANPLL_S)
197 OTPC (GLOBAL_OTPC_S)
200 VPR120 (GLOBAL_VPR120_S)
209 IPCT120 (GLOBAL_IPCT120_NS, GLOBAL_IPCT120_S)
211 I3C120 (GLOBAL_I3C120_NS, GLOBAL_I3C120_S)
212 VPR121 (GLOBAL_VPR121_NS, GLOBAL_VPR121_S)
216 CAN (GLOBAL_CAN_NS, GLOBAL_CAN_S)
222 I3C121 (GLOBAL_I3C121_NS, GLOBAL_I3C121_S)
226 TIMER120 (GLOBAL_TIMER120_NS, GLOBAL_TIMER120_S)
227 TIMER121 (GLOBAL_TIMER121_NS, GLOBAL_TIMER121_S)
228 PWM120 (GLOBAL_PWM120_NS, GLOBAL_PWM120_S)
229 SPIS120_UARTE120 (GLOBAL_SPIS120_NS, GLOBAL_UARTE120_NS, GLOBAL_SPIS120_S, GLOBAL_UARTE120_S)
230 SPIM120 (GLOBAL_SPIM120_NS, GLOBAL_SPIM120_S)
231 SPIM121 (GLOBAL_SPIM121_NS, GLOBAL_SPIM121_S)
232 TWIM120 (GLOBAL_TWIM120_NS, GLOBAL_TWIM120_S)
264 VPR130 (GLOBAL_VPR130_NS, GLOBAL_VPR130_S)
289 IPCT130 (GLOBAL_IPCT130_NS, GLOBAL_IPCT130_S)
296 RTC130 (GLOBAL_RTC130_NS, GLOBAL_RTC130_S)
297 RTC131 (GLOBAL_RTC131_NS, GLOBAL_RTC131_S)
298 WDT130 (WDT130_S)
299 WDT131 (GLOBAL_WDT131_NS, GLOBAL_WDT131_S)
300 WDT132 (GLOBAL_WDT132_NS, GLOBAL_WDT132_S)
301 EGU130 (GLOBAL_EGU130_NS, GLOBAL_EGU130_S)
320 GRCCONF0 (GRCCONF_S)
321 GRCCONF1 (GRCCONF_S)
322 GRCCONF2 (GRCCONF_S)
323 PCRM (PCRM_S)
329 RESETHUB (RESETHUB_S)
336 CLOCK (CLOCK_S)
337 LFRC (LFRC_S)
338 GGENERIC18 (GGENERIC18_S)
339 LFXO (LFXO_S)
340 FLL16M (FLL16M_S)
341 HFXO (HFXO_S)
343 AUDIOPLL (AUDIOPLL_S)
344 USBHSPLL (USBHSPLL_S)
352 POWER (POWER_S)
353 VREGMAIN (VREGMAIN_S)
354 VREGAO1V8 (VREGAO1V8_S)
355 VREG1V0 (VREG1V0_S)
356 VREGAO0V8 (VREGAO0V8_S)
357 VREGVS0V8 (VREGVS0V8_S)
359 VREGUSB (VREGUSB_S)
360 AUDIOPLLPM (AUDIOPLLPM_S)
361 VREGMRAM130 (VREGMRAM130_S)
362 VREGMRAM131 (VREGMRAM131_S)
365 MBIAS (MBIAS_S)
368 VDETAO1V8 (VDETAO1V8_S)
369 VDETAO0V8 (VDETAO0V8_S)
370 VDETVS0V8 (VDETVS0V8_S)
373 VDETAO5V0 (VDETAO5V0_S)
374 VDET1V0 (VDET1V0_S)
386 SAADC (GLOBAL_SAADC_NS, GLOBAL_SAADC_S)
387 COMP_LPCOMP (GLOBAL_COMP_NS, GLOBAL_LPCOMP_NS, GLOBAL_COMP_S, GLOBAL_LPCOMP_S)
388 TEMP (GLOBAL_TEMP_NS, GLOBAL_TEMP_S)
389 NFCT (GLOBAL_NFCT_NS, GLOBAL_NFCT_S)
402 I2S130 (GLOBAL_I2S130_NS, GLOBAL_I2S130_S)
403 PDM (GLOBAL_PDM_NS, GLOBAL_PDM_S)
404 QDEC130 (GLOBAL_QDEC130_NS, GLOBAL_QDEC130_S)
405 QDEC131 (GLOBAL_QDEC131_NS, GLOBAL_QDEC131_S)
406 SIMIF (GLOBAL_SIMIF_NS, GLOBAL_SIMIF_S)
407 I2S131 (GLOBAL_I2S131_NS, GLOBAL_I2S131_S)
411 MIPIRFFE (GLOBAL_MIPIRFFE_NS, GLOBAL_MIPIRFFE_S)
418 TIMER130 (GLOBAL_TIMER130_NS, GLOBAL_TIMER130_S)
419 TIMER131 (GLOBAL_TIMER131_NS, GLOBAL_TIMER131_S)
420 PWM130 (GLOBAL_PWM130_NS, GLOBAL_PWM130_S)
421 SERIAL0 (GLOBAL_SPIM130_NS, GLOBAL_SPIS130_NS, GLOBAL_TWIM130_NS, GLOBAL_TWIS130_NS, GLOBAL_UARTE130_NS, GLOBAL_SPIM130_S, GLOBAL_SPIS130_S, GLOBAL_TWIM130_S, GLOBAL_TWIS130_S, GLOBAL_UARTE130_S)
422 SERIAL1 (GLOBAL_SPIM131_NS, GLOBAL_SPIS131_NS, GLOBAL_TWIM131_NS, GLOBAL_TWIS131_NS, GLOBAL_UARTE131_NS, GLOBAL_SPIM131_S, GLOBAL_SPIS131_S, GLOBAL_TWIM131_S, GLOBAL_TWIS131_S, GLOBAL_UARTE131_S)
434 TIMER132 (GLOBAL_TIMER132_NS, GLOBAL_TIMER132_S)
435 TIMER133 (GLOBAL_TIMER133_NS, GLOBAL_TIMER133_S)
436 PWM131 (GLOBAL_PWM131_NS, GLOBAL_PWM131_S)
437 SERIAL2 (GLOBAL_SPIM132_NS, GLOBAL_SPIS132_NS, GLOBAL_TWIM132_NS, GLOBAL_TWIS132_NS, GLOBAL_UARTE132_NS, GLOBAL_SPIM132_S, GLOBAL_SPIS132_S, GLOBAL_TWIM132_S, GLOBAL_TWIS132_S, GLOBAL_UARTE132_S)
438 SERIAL3 (GLOBAL_SPIM133_NS, GLOBAL_SPIS133_NS, GLOBAL_TWIM133_NS, GLOBAL_TWIS133_NS, GLOBAL_UARTE133_NS, GLOBAL_SPIM133_S, GLOBAL_SPIS133_S, GLOBAL_TWIM133_S, GLOBAL_TWIS133_S, GLOBAL_UARTE133_S)
450 TIMER134 (GLOBAL_TIMER134_NS, GLOBAL_TIMER134_S)
451 TIMER135 (GLOBAL_TIMER135_NS, GLOBAL_TIMER135_S)
452 PWM132 (GLOBAL_PWM132_NS, GLOBAL_PWM132_S)
453 SERIAL4 (GLOBAL_SPIM134_NS, GLOBAL_SPIS134_NS, GLOBAL_TWIM134_NS, GLOBAL_TWIS134_NS, GLOBAL_UARTE134_NS, GLOBAL_SPIM134_S, GLOBAL_SPIS134_S, GLOBAL_TWIM134_S, GLOBAL_TWIS134_S, GLOBAL_UARTE134_S)
454 SERIAL5 (GLOBAL_SPIM135_NS, GLOBAL_SPIS135_NS, GLOBAL_TWIM135_NS, GLOBAL_TWIS135_NS, GLOBAL_UARTE135_NS, GLOBAL_SPIM135_S, GLOBAL_SPIS135_S, GLOBAL_TWIM135_S, GLOBAL_TWIS135_S, GLOBAL_UARTE135_S)
466 TIMER136 (GLOBAL_TIMER136_NS, GLOBAL_TIMER136_S)
467 TIMER137 (GLOBAL_TIMER137_NS, GLOBAL_TIMER137_S)
468 PWM133 (GLOBAL_PWM133_NS, GLOBAL_PWM133_S)
469 SERIAL6 (GLOBAL_SPIM136_NS, GLOBAL_SPIS136_NS, GLOBAL_TWIM136_NS, GLOBAL_TWIS136_NS, GLOBAL_UARTE136_NS, GLOBAL_SPIM136_S, GLOBAL_SPIS136_S, GLOBAL_TWIM136_S, GLOBAL_TWIS136_S, GLOBAL_UARTE136_S)
470 SERIAL7 (GLOBAL_SPIM137_NS, GLOBAL_SPIS137_NS, GLOBAL_TWIM137_NS, GLOBAL_TWIS137_NS, GLOBAL_UARTE137_NS, GLOBAL_SPIM137_S, GLOBAL_SPIS137_S, GLOBAL_TWIM137_S, GLOBAL_TWIS137_S, GLOBAL_UARTE137_S)

## Further device data
MaxInterrupts=480

## Licence text in the file
Copyright (c) 2010 - 2022, Nordic Semiconductor ASA All rights reserved. Redistribution and use in source and binary forms, with or without modification, are permitted provided that the following conditions are met: 1. Redistributions of source code must retain the above copyright notice, this list of conditions and the following disclaimer. 2. Redistributions in binary form, except as embedded into a Nordic Semiconductor ASA integrated circuit in a product or a software update for such product, must reproduce the above copyright notice, this list of conditions and the following disclaimer in the documentation and/or other materials provided with the distribution. 3. Neither the name of Nordic Semiconductor ASA nor the names of its contributors may be used to endorse or promote products derived from this software without specific prior written permission. 4. This software, with or without modification, must only be used with a Nordic Semiconductor ASA integrated circuit. 5. Any software provided in binary form under this license must not be reverse engineered, decompiled, modified and/or disassembled. THIS SOFTWARE IS PROVIDED BY NORDIC SEMICONDUCTOR ASA "AS IS" AND ANY EXPRESS OR IMPLIED WARRANTIES, INCLUDING, BUT NOT LIMITED TO, THE IMPLIED WARRANTIES OF MERCHANTABILITY, NONINFRINGEMENT, AND FITNESS FOR A PARTICULAR PURPOSE ARE DISCLAIMED. IN NO EVENT SHALL NORDIC SEMICONDUCTOR ASA OR CONTRIBUTORS BE LIABLE FOR ANY DIRECT, INDIRECT, INCIDENTAL, SPECIAL, EXEMPLARY, OR CONSEQUENTIAL DAMAGES (INCLUDING, BUT NOT LIMITED TO, PROCUREMENT OF SUBSTITUTE GOODS OR SERVICES; LOSS OF USE, DATA, OR PROFITS; OR BUSINESS INTERRUPTION) HOWEVER CAUSED AND ON ANY THEORY OF LIABILITY, WHETHER IN CONTRACT, STRICT LIABILITY, OR TORT (INCLUDING NEGLIGENCE OR OTHERWISE) ARISING IN ANY WAY OUT OF THE USE OF THIS SOFTWARE, EVEN IF ADVISED OF THE POSSIBILITY OF SUCH DAMAGE.
