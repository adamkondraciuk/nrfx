# haltium_celldsp register map
Vendor: Nordic Semiconductor; Series: nRFHaltium; File version: 1
nRFHaltium reference description for system-on-chip with many ARM 32-bit Cortex-M33 microcontrollers
Registers are 32-bit, read-write, reset 0x0 unless marked. A register's access mark holds for its fields unless they carry their own. Offsets are from the block's base; lines under a group give offsets from that group; [hi:lo] are bit positions; {n}, {i} and the like mark numbered series; 'fields as' and 'values as' point back to an identical list; <NAME> marks a mode.

## Memory map
0x0FFFE000 GLOBAL_FICR size 0x4000 — Factory Information Configuration Registers
0x26000000 LSTMDATA size 0x10000000 — System Trace Macrocell data buffer 0
0x2F700000 GLOBAL_USBHSCORE0 size 0x24000 — USBHSCORE
0x2FBE0000 GLOBAL_I3CCORE120 size 0x1000 — I3CCORE 0
0x2FBE1000 GLOBAL_I3CCORE121 size 0x1000 — I3CCORE 1
0x45000000 HSFLL size 0x1000
0x45001000 LRCCONF0 size 0x1000
0x45002000 MPC size 0x1000 — Memory Privilege Controller
0x45003000 MVDMA size 0x1000 — MVDMA performs direct-memory-accesses between memories. Data is transferred according to job descriptor lists. Each transfer has corresponding source and sink descriptor lists with matching data amounts. The lists are in memory and they contain data buffer information, address pointers, buffer sizes and data type attributes. MVDMA IP connects to an ARM standard AXI4 bus.
0x45004000 RAMC00 size 0x1000 — RAM Controller 0
0x45005000 RAMC10 size 0x1000 — RAM Controller 1
0x45006000 RAMC20 size 0x1000 — RAM Controller 2
0x45007000 GENERIC2 size 0x1000 — GENERIC 3
0x45008000 DSPINTMAP size 0x1000 — DSP interrupt mapper
0x45009000 MWU size 0x1000 — Memory Watch Unit
0x4500A000 LTEFE size 0x1000 — LTE Front End
0x4500B000 TURBO size 0x1000 — Decoding
0x4500C000 HARQ size 0x1000 — LTE HARQ
0x4500D000 VITERBI size 0x1000
0x4500E000 PPIB0 size 0x1000 — PPIB APB registers 0
0x45010000 LRCCONF1 size 0x1000
0x45011000 CPUCONF size 0x1000 — CPU Configuration
0x45012000 MEMCONF size 0x1000 — Memory configuration
0x45013000 IPCT size 0x1000 — IPCT APB registers
0x45014000 DSPCTRL size 0x1000 — DSP control
0x45015000 PCGCM0 size 0x1000 — PCGC Master 0
0x45016000 PPIB1 size 0x1000 — PPIB APB registers 1
0x45020000 CTI0 size 0x1000 — Cross-Trigger Interface control 2
0x45021000 DPPIC size 0x1000 — Distributed programmable peripheral interconnect controller 0
0x45022000 PCGCS0 size 0x1000 — PCGCSlave
0x45023000 PCGCM1 size 0x1000 — PCGC Master 1
0x45024000 LSTM size 0x1000 — System Trace Macrocell 1
0x45025000 ETM size 0x1000 — Embedded Trace Macrocell
0x45026000 CTI1 size 0x1000 — Cross-Trigger Interface control 3
0x45027000 TRACEDELAYREG size 0x1000 — Trace delay register
0x4F09D000 BELLBOARD size 0x1000 — BELLBOARD APB registers
0x4F8D1000 GLOBAL_IPCT120 size 0x1000 — IPCT APB registers 0
0x4F8D2000 GLOBAL_MUTEX120 size 0x1000 — MUTEX 0
0x4F8D3000 GLOBAL_I3C120 size 0x1000 — I3C 0
0x4F8D4000 GLOBAL_I3C121 size 0x1000 — I3C 1
0x4F8D5000 GLOBAL_CAN size 0x1000 — GENERIC 4
0x4F8E1000 GLOBAL_DPPIC120 size 0x1000 — Distributed programmable peripheral interconnect controller 1
0x4F8E2000 GLOBAL_TIMER120 size 0x1000 — Timer/Counter 0
0x4F8E3000 GLOBAL_TIMER121 size 0x1000 — Timer/Counter 1
0x4F8E4000 GLOBAL_PWM120 size 0x1000 — Pulse width modulation unit 0
0x4F8E5000 GLOBAL_SPIS120 size 0x1000 — SPI Slave 0
0x4F8E6000 GLOBAL_SPIM120 size 0x1000 — Serial Peripheral Interface Master with EasyDMA 0
0x4F8E7000 GLOBAL_SPIM121 size 0x1000 — Serial Peripheral Interface Master with EasyDMA 1
0x4F8E8000 GLOBAL_TWIM120 size 0x1000 — I2C compatible Two-Wire Master Interface with EasyDMA 0
0x4F921000 GLOBAL_IPCT130 size 0x1000 — IPCT APB registers 1
0x4F922000 GLOBAL_DPPIC130 size 0x1000 — Distributed programmable peripheral interconnect controller 2
0x4F927000 GLOBAL_MUTEX130 size 0x1000 — MUTEX 1
0x4F928000 GLOBAL_RTC130 size 0x1000 — Real-time counter 0
0x4F929000 GLOBAL_RTC131 size 0x1000 — Real-time counter 1
0x4F92B000 GLOBAL_WDT131 size 0x1000 — Watchdog Timer 0
0x4F92C000 GLOBAL_WDT132 size 0x1000 — Watchdog Timer 1
0x4F92D000 GLOBAL_EGU130 size 0x1000 — Event generator unit
0x4F934000 GLOBAL_GPIOTE130 size 0x1000 — GPIO Tasks and Events 0
0x4F935000 GLOBAL_GPIOTE131 size 0x1000 — GPIO Tasks and Events 1
{0x4F938000+0x200*n} GLOBAL_P{n} size 0x200 (n=0..15) — GPIO Port {n}
0x4F939E00 GLOBAL_GPIOINTERNAL size 0x2000 — GPIO Internal
0x4F981000 GLOBAL_DPPIC131 size 0x1000 — Distributed programmable peripheral interconnect controller 3
0x4F982000 GLOBAL_SAADC size 0x1000 — Analog to Digital Converter
0x4F983000 GLOBAL_COMP size 0x1000 — Comparator
0x4F983000 GLOBAL_LPCOMP size 0x1000 — Low-power comparator
0x4F984000 GLOBAL_TEMP size 0x1000 — Temperature Sensor
0x4F985000 GLOBAL_NFCT size 0x1000 — NFC-A compatible radio
0x4F991000 GLOBAL_DPPIC132 size 0x1000 — Distributed programmable peripheral interconnect controller 4
0x4F992000 GLOBAL_I2S130 size 0x1000 — Inter-IC Sound 0
0x4F993000 GLOBAL_PDM size 0x1000 — Pulse Density Modulation (Digital Microphone) Interface
0x4F994000 GLOBAL_QDEC130 size 0x1000 — Quadrature Decoder 0
0x4F995000 GLOBAL_QDEC131 size 0x1000 — Quadrature Decoder 1
0x4F996000 GLOBAL_SIMIF size 0x1000 — SIM card interface
0x4F997000 GLOBAL_I2S131 size 0x1000 — Inter-IC Sound 1
0x4F998000 GLOBAL_MIPIRFFE size 0x1000 — MipiRffe Master
0x4F99C000 GLOBAL_GRTC size 0x1000 — Global Real-time counter
0x4F9A1000 GLOBAL_DPPIC133 size 0x1000 — Distributed programmable peripheral interconnect controller 5
0x4F9A2000 GLOBAL_TIMER130 size 0x1000 — Timer/Counter 2
0x4F9A3000 GLOBAL_TIMER131 size 0x1000 — Timer/Counter 3
0x4F9A4000 GLOBAL_PWM130 size 0x1000 — Pulse width modulation unit 1
0x4F9A5000 GLOBAL_SPIM130 size 0x1000 — Serial Peripheral Interface Master with EasyDMA 2
0x4F9A5000 GLOBAL_SPIS130 size 0x1000 — SPI Slave 1
0x4F9A5000 GLOBAL_TWIM130 size 0x1000 — I2C compatible Two-Wire Master Interface with EasyDMA 1
0x4F9A5000 GLOBAL_TWIS130 size 0x1000 — I2C compatible Two-Wire Slave Interface with EasyDMA 0
0x4F9A5000 GLOBAL_UARTE130 size 0x1000 — UART with EasyDMA 0
0x4F9A6000 GLOBAL_SPIM131 size 0x1000 — Serial Peripheral Interface Master with EasyDMA 3
0x4F9A6000 GLOBAL_SPIS131 size 0x1000 — SPI Slave 2
0x4F9A6000 GLOBAL_TWIM131 size 0x1000 — I2C compatible Two-Wire Master Interface with EasyDMA 2
0x4F9A6000 GLOBAL_TWIS131 size 0x1000 — I2C compatible Two-Wire Slave Interface with EasyDMA 1
0x4F9A6000 GLOBAL_UARTE131 size 0x1000 — UART with EasyDMA 1
0x4F9B1000 GLOBAL_DPPIC134 size 0x1000 — Distributed programmable peripheral interconnect controller 6
0x4F9B2000 GLOBAL_TIMER132 size 0x1000 — Timer/Counter 4
0x4F9B3000 GLOBAL_TIMER133 size 0x1000 — Timer/Counter 5
0x4F9B4000 GLOBAL_PWM131 size 0x1000 — Pulse width modulation unit 2
0x4F9B5000 GLOBAL_SPIM132 size 0x1000 — Serial Peripheral Interface Master with EasyDMA 4
0x4F9B5000 GLOBAL_SPIS132 size 0x1000 — SPI Slave 3
0x4F9B5000 GLOBAL_TWIM132 size 0x1000 — I2C compatible Two-Wire Master Interface with EasyDMA 3
0x4F9B5000 GLOBAL_TWIS132 size 0x1000 — I2C compatible Two-Wire Slave Interface with EasyDMA 2
0x4F9B5000 GLOBAL_UARTE132 size 0x1000 — UART with EasyDMA 2
0x4F9B6000 GLOBAL_SPIM133 size 0x1000 — Serial Peripheral Interface Master with EasyDMA 5
0x4F9B6000 GLOBAL_SPIS133 size 0x1000 — SPI Slave 4
0x4F9B6000 GLOBAL_TWIM133 size 0x1000 — I2C compatible Two-Wire Master Interface with EasyDMA 4
0x4F9B6000 GLOBAL_TWIS133 size 0x1000 — I2C compatible Two-Wire Slave Interface with EasyDMA 3
0x4F9B6000 GLOBAL_UARTE133 size 0x1000 — UART with EasyDMA 3
0x4F9C1000 GLOBAL_DPPIC135 size 0x1000 — Distributed programmable peripheral interconnect controller 7
0x4F9C2000 GLOBAL_TIMER134 size 0x1000 — Timer/Counter 6
0x4F9C3000 GLOBAL_TIMER135 size 0x1000 — Timer/Counter 7
0x4F9C4000 GLOBAL_PWM132 size 0x1000 — Pulse width modulation unit 3
0x4F9C5000 GLOBAL_SPIM134 size 0x1000 — Serial Peripheral Interface Master with EasyDMA 6
0x4F9C5000 GLOBAL_SPIS134 size 0x1000 — SPI Slave 5
0x4F9C5000 GLOBAL_TWIM134 size 0x1000 — I2C compatible Two-Wire Master Interface with EasyDMA 5
0x4F9C5000 GLOBAL_TWIS134 size 0x1000 — I2C compatible Two-Wire Slave Interface with EasyDMA 4
0x4F9C5000 GLOBAL_UARTE134 size 0x1000 — UART with EasyDMA 4
0x4F9C6000 GLOBAL_SPIM135 size 0x1000 — Serial Peripheral Interface Master with EasyDMA 7
0x4F9C6000 GLOBAL_SPIS135 size 0x1000 — SPI Slave 6
0x4F9C6000 GLOBAL_TWIM135 size 0x1000 — I2C compatible Two-Wire Master Interface with EasyDMA 6
0x4F9C6000 GLOBAL_TWIS135 size 0x1000 — I2C compatible Two-Wire Slave Interface with EasyDMA 5
0x4F9C6000 GLOBAL_UARTE135 size 0x1000 — UART with EasyDMA 5
0x4F9D1000 GLOBAL_DPPIC136 size 0x1000 — Distributed programmable peripheral interconnect controller 8
0x4F9D2000 GLOBAL_TIMER136 size 0x1000 — Timer/Counter 8
0x4F9D3000 GLOBAL_TIMER137 size 0x1000 — Timer/Counter 9
0x4F9D4000 GLOBAL_PWM133 size 0x1000 — Pulse width modulation unit 4
0x4F9D5000 GLOBAL_SPIM136 size 0x1000 — Serial Peripheral Interface Master with EasyDMA 8
0x4F9D5000 GLOBAL_SPIS136 size 0x1000 — SPI Slave 7
0x4F9D5000 GLOBAL_TWIM136 size 0x1000 — I2C compatible Two-Wire Master Interface with EasyDMA 7
0x4F9D5000 GLOBAL_TWIS136 size 0x1000 — I2C compatible Two-Wire Slave Interface with EasyDMA 6
0x4F9D5000 GLOBAL_UARTE136 size 0x1000 — UART with EasyDMA 6
0x4F9D6000 GLOBAL_SPIM137 size 0x1000 — Serial Peripheral Interface Master with EasyDMA 9
0x4F9D6000 GLOBAL_SPIS137 size 0x1000 — SPI Slave 8
0x4F9D6000 GLOBAL_TWIM137 size 0x1000 — I2C compatible Two-Wire Master Interface with EasyDMA 8
0x4F9D6000 GLOBAL_TWIS137 size 0x1000 — I2C compatible Two-Wire Slave Interface with EasyDMA 7
0x4F9D6000 GLOBAL_UARTE137 size 0x1000 — UART with EasyDMA 7
0x5F086000 GLOBAL_USBHS size 0x1000 — USBHS
0x5F9E0000 GLOBAL_EASYVDMA size 0x1000 — Vector-based DMA.
0xA0000000 GLOBAL_STMDATA size 0x10000000 — System Trace Macrocell data buffer 1
0xBF001000 GLOBAL_TDDCONF size 0x1000 — TDDCONF
0xBF003000 GLOBAL_TBM size 0x1000 — Trace buffer monitor
0xBF041000 GLOBAL_TSGEN size 0x1000 — GENERIC 0
0xBF042000 GLOBAL_STM size 0x1000 — System Trace Macrocell 0
0xBF043000 GLOBAL_TPIU size 0x1000 — Trace Port Interface Unit
0xBF044000 GLOBAL_ETB size 0x1000 — GENERIC 1
0xBF045000 GLOBAL_ETR size 0x1000 — GENERIC 2
0xBF046000 GLOBAL_CTI210 size 0x1000 — Cross-Trigger Interface control 0
0xBF047000 GLOBAL_CTI211 size 0x1000 — Cross-Trigger Interface control 1
0xBF048000 GLOBAL_ATBREPLICATOR210 size 0x1000 — ATB Replicator module 0
0xBF049000 GLOBAL_ATBREPLICATOR211 size 0x1000 — ATB Replicator module 1
0xBF04A000 GLOBAL_ATBREPLICATOR212 size 0x1000 — ATB Replicator module 2
0xBF04B000 GLOBAL_ATBREPLICATOR213 size 0x1000 — ATB Replicator module 3
0xBF04C000 GLOBAL_ATBFUNNEL210 size 0x1000 — ATB funnel module 0
0xBF04D000 GLOBAL_ATBFUNNEL211 size 0x1000 — ATB funnel module 1
0xBF04E000 GLOBAL_ATBFUNNEL212 size 0x1000 — ATB funnel module 2
0xBF04F000 GLOBAL_ATBFUNNEL213 size 0x1000 — ATB funnel module 3

## Interrupts
0 HSFLL
1 LRCCONF0
2 MPC
3 MVDMA
4 RAMC00
5 RAMC10
6 RAMC20
7 GENERIC2
9 MWU
10 LTEFE0 (LTEFE)
11 LTEFE1 (LTEFE)
12 HARQ0_LTEFE2 (LTEFE, HARQ)
13 HARQ1_LTEFE3_VITERBI0 (LTEFE, HARQ, VITERBI)
14 HARQ2_LTEFE4_VITERBI1 (LTEFE, HARQ, VITERBI)
15 HARQ3_LTEFE5_VITERBI2 (LTEFE, HARQ, VITERBI)
16 HARQ4_LRCCONF1_LTEFE6_VITERBI3 (LTEFE, HARQ, VITERBI, LRCCONF1)
17 HARQ5_LTEFE7 (LTEFE, HARQ)
18 HARQ6_LTEFE8 (LTEFE, HARQ)
19 HARQ7_IPCT0_LTEFE9 (LTEFE, HARQ, IPCT)
20 IPCT1_LTEFE10 (LTEFE, IPCT)
21 IPCT2_LTEFE11 (LTEFE, IPCT)
22 LTEFE12 (LTEFE)
23 LTEFE13 (LTEFE)
24 LTEFE14 (LTEFE)
25 LTEFE15 (LTEFE)
96 BELLBOARD0 (BELLBOARD)
97 BELLBOARD1 (BELLBOARD)
98 BELLBOARD2 (BELLBOARD)
99 BELLBOARD3 (BELLBOARD)
104 GPIOTE1300 (GLOBAL_GPIOTE130)
105 GPIOTE1301 (GLOBAL_GPIOTE130)
106 GPIOTE1310 (GLOBAL_GPIOTE131)
107 GPIOTE1311 (GLOBAL_GPIOTE131)
{n+108} GRTC{n} (GLOBAL_GRTC) (n=0..15)
134 USBHS (GLOBAL_USBHS)
209 IPCT1200 (GLOBAL_IPCT120)
211 I3C120 (GLOBAL_I3C120)
212 I3C121 (GLOBAL_I3C121)
213 CAN (GLOBAL_CAN)
226 TIMER120 (GLOBAL_TIMER120)
227 TIMER121 (GLOBAL_TIMER121)
228 PWM120 (GLOBAL_PWM120)
229 SPIS120 (GLOBAL_SPIS120)
230 SPIM120 (GLOBAL_SPIM120)
231 SPIM121 (GLOBAL_SPIM121)
232 TWIM120 (GLOBAL_TWIM120)
289 IPCT1300 (GLOBAL_IPCT130)
296 RTC130 (GLOBAL_RTC130)
297 RTC131 (GLOBAL_RTC131)
299 WDT131 (GLOBAL_WDT131)
300 WDT132 (GLOBAL_WDT132)
301 EGU130 (GLOBAL_EGU130)
386 SAADC (GLOBAL_SAADC)
387 COMP_LPCOMP (GLOBAL_COMP, GLOBAL_LPCOMP)
388 TEMP (GLOBAL_TEMP)
389 NFCT (GLOBAL_NFCT)
402 I2S130 (GLOBAL_I2S130)
403 PDM (GLOBAL_PDM)
404 QDEC130 (GLOBAL_QDEC130)
405 QDEC131 (GLOBAL_QDEC131)
406 SIMIF (GLOBAL_SIMIF)
407 I2S131 (GLOBAL_I2S131)
408 MIPIRFFE (GLOBAL_MIPIRFFE)
418 TIMER130 (GLOBAL_TIMER130)
419 TIMER131 (GLOBAL_TIMER131)
420 PWM130 (GLOBAL_PWM130)
421 SERIAL0 (GLOBAL_SPIM130, GLOBAL_SPIS130, GLOBAL_TWIM130, GLOBAL_TWIS130, GLOBAL_UARTE130)
422 SERIAL1 (GLOBAL_SPIM131, GLOBAL_SPIS131, GLOBAL_TWIM131, GLOBAL_TWIS131, GLOBAL_UARTE131)
434 TIMER132 (GLOBAL_TIMER132)
435 TIMER133 (GLOBAL_TIMER133)
436 PWM131 (GLOBAL_PWM131)
437 SERIAL2 (GLOBAL_SPIM132, GLOBAL_SPIS132, GLOBAL_TWIM132, GLOBAL_TWIS132, GLOBAL_UARTE132)
438 SERIAL3 (GLOBAL_SPIM133, GLOBAL_SPIS133, GLOBAL_TWIM133, GLOBAL_TWIS133, GLOBAL_UARTE133)
450 TIMER134 (GLOBAL_TIMER134)
451 TIMER135 (GLOBAL_TIMER135)
452 PWM132 (GLOBAL_PWM132)
453 SERIAL4 (GLOBAL_SPIM134, GLOBAL_SPIS134, GLOBAL_TWIM134, GLOBAL_TWIS134, GLOBAL_UARTE134)
454 SERIAL5 (GLOBAL_SPIM135, GLOBAL_SPIS135, GLOBAL_TWIM135, GLOBAL_TWIS135, GLOBAL_UARTE135)
466 TIMER136 (GLOBAL_TIMER136)
467 TIMER137 (GLOBAL_TIMER137)
468 PWM133 (GLOBAL_PWM133)
469 SERIAL6 (GLOBAL_SPIM136, GLOBAL_SPIS136, GLOBAL_TWIM136, GLOBAL_TWIS136, GLOBAL_UARTE136)
470 SERIAL7 (GLOBAL_SPIM137, GLOBAL_SPIS137, GLOBAL_TWIM137, GLOBAL_TWIS137, GLOBAL_UARTE137)

## Further device data
MaxInterrupts=480

## Licence text in the file
Copyright (c) 2010 - 2021, Nordic Semiconductor ASA All rights reserved. Redistribution and use in source and binary forms, with or without modification, are permitted provided that the following conditions are met: 1. Redistributions of source code must retain the above copyright notice, this list of conditions and the following disclaimer. 2. Redistributions in binary form, except as embedded into a Nordic Semiconductor ASA integrated circuit in a product or a software update for such product, must reproduce the above copyright notice, this list of conditions and the following disclaimer in the documentation and/or other materials provided with the distribution. 3. Neither the name of Nordic Semiconductor ASA nor the names of its contributors may be used to endorse or promote products derived from this software without specific prior written permission. 4. This software, with or without modification, must only be used with a Nordic Semiconductor ASA integrated circuit. 5. Any software provided in binary form under this license must not be reverse engineered, decompiled, modified and/or disassembled. THIS SOFTWARE IS PROVIDED BY NORDIC SEMICONDUCTOR ASA "AS IS" AND ANY EXPRESS OR IMPLIED WARRANTIES, INCLUDING, BUT NOT LIMITED TO, THE IMPLIED WARRANTIES OF MERCHANTABILITY, NONINFRINGEMENT, AND FITNESS FOR A PARTICULAR PURPOSE ARE DISCLAIMED. IN NO EVENT SHALL NORDIC SEMICONDUCTOR ASA OR CONTRIBUTORS BE LIABLE FOR ANY DIRECT, INDIRECT, INCIDENTAL, SPECIAL, EXEMPLARY, OR CONSEQUENTIAL DAMAGES (INCLUDING, BUT NOT LIMITED TO, PROCUREMENT OF SUBSTITUTE GOODS OR SERVICES; LOSS OF USE, DATA, OR PROFITS; OR BUSINESS INTERRUPTION) HOWEVER CAUSED AND ON ANY THEORY OF LIABILITY, WHETHER IN CONTRACT, STRICT LIABILITY, OR TORT (INCLUDING NEGLIGENCE OR OTHERWISE) ARISING IN ANY WAY OUT OF THE USE OF THIS SOFTWARE, EVEN IF ADVISED OF THE POSSIBILITY OF SUCH DAMAGE.
