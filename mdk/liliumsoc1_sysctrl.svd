# liliumSOC1_sysctrl register map
Vendor: Nordic Semiconductor; Series: liliumSOC1; File version: 1
Registers are 32-bit, read-write, reset 0x0 unless marked. A register's access mark holds for its fields unless they carry their own. Offsets are from the block's base; [hi:lo] are bit positions; lines under a group give offsets from that group; {n}, {i} and the like mark numbered series; 'fields as' and 'values as' point back to an identical list.

## OICR_S — One time programmable Information Configuration Registers
Base 0x2F840000
0x00 USER group — Unspecified
  {0x0+0x2C*j} PUBKEY[{j}] (j=0..3) group — Unspecified
    {0x0+4k} DIGEST[{k}] (k=0..7) ro reset 0xFFFFFFFF — Description collection: First 256 bits of SHA2-512 digest for user public key [n].
      [31:0] VALUE — Value for word [o] in the key digest [n].
    {0x20+4k} REVOKE[{k}] (k=0..2) reset 0xFFFFFFFF — Description collection: Revocation status of public key [n].
      [31:0] STATUS — Revocation status.
        0xFFFFFFFF=NotRevoked (Key not revoked.)
  {0xB0+0x2C*j} AUTHOPKEY[{j}] (j=0..3) group — Unspecified
    {0x0+4k} DIGEST[{k}] (k=0..7) ro reset 0xFFFFFFFF — Description collection: First 256 bits of SHA2-512 digest for user authentication key [n].
      [31:0] VALUE — Value for word [o] in the key digest [n].
    {0x20+4k} REVOKE[{k}] (k=0..2) reset 0xFFFFFFFF — Description collection: Revocation status of authentication key [n].
      fields as USER.PUBKEY[0].REVOKE[0]
  {0x160+4j} DATA[{j}] (j=0..31) reset 0xFFFFFFFF — Description collection: Reserved for user data.
    [31:0] DATA
0x200 NORDIC group — Unspecified
  {0x0+0x2C*j} PUBKEY[{j}] (j=0..3) group — Unspecified
    {0x0+4k} DIGEST[{k}] (k=0..7) ro reset 0xFFFFFFFF — Description collection: First 256 bits of SHA2-512 digest for Nordic public key [n].
      [31:0] VALUE — Value for word [o] in the key digest [n].
    {0x20+4k} REVOKE[{k}] (k=0..2) reset 0xFFFFFFFF — Description collection: Revocation status of public key [n].
      fields as USER.PUBKEY[0].REVOKE[0]
  {0xB0+0x2C*j} AUTHOPKEY[{j}] (j=0..3) group — Unspecified
    {0x0+4k} DIGEST[{k}] (k=0..7) ro reset 0xFFFFFFFF — Description collection: First 256 bits of SHA2-512 digest for Nordic authentication key [n].
      [31:0] VALUE — Value for word [o] in the key digest [n].
    {0x20+4k} REVOKE[{k}] (k=0..2) reset 0xFFFFFFFF — Description collection: Revocation status of authentication key [n].
      fields as USER.PUBKEY[0].REVOKE[0]
0x360 CRACEN group — Unspecified
  {0x0+0x20*j} KEY[{j}] (j=0..3) group — Unspecified
    {0x0+4k} VALUE[{k}] (k=0..7) ro reset 0xFFFFFFFF — Description collection: Value for the CRACEN KEY[n].
      [31:0] VALUE — Value for word [o] in the CRACEN.KEY[n].
0x3E0 DEVICE group — Unspecified
  {0x0+4j} UUID[{j}] (j=0..3) ro reset 0xFFFFFFFF — Description collection: 128-bit Universally Unique IDentifier (UUID).
    [31:0] UUID — Device UUID [n].
0x400 LCS group — Unspecified
  {0x0+4j} FFF[{j}] (j=0..2) reset 0xFFFFFFFF — Description collection: Life cycle state FFF encoding.
  {0xC+4j} DISCARDED[{j}] (j=0..2) reset 0xFFFFFFFF — Description collection: Life cycle state DISCARDED encoding.
  {0x18+4j} ANALYSIS[{j}] (j=0..2) reset 0xFFFFFFFF — Description collection: Life cycle state ANALYSIS encoding.
0x460 PUF group — Unspecified
  0x00 STATUS ro reset 0xFFFFFFFF — PUF enrollment status
    [0] STATUS — PUF enrollment status.
      0=Enrolled (PUF enrollment has been completed.); 1=NotEnrolled (PUF enrollment has not been done.)
0x480 INFO group — Unspecified
  0x00 TYPE ro reset 0xFFFFFFFF — Device type.
    [31:0] TYPE
      0=Die (Device is a physical DIE.); 0xFFFFFFFF=FPGA (Device is a FPGA.)
  {0x4+4j} TESTIMPRINT[{j}] (j=0..7) ro reset 0xFFFFFFFF — Description collection: Production test imprint.
    [31:0] TESTIMPRINT — Production test imprint.
0x500 PRECALIB group — Unspecified
  0x00 PRECALIBRDY ro reset 0xFFFFFFFF — PRECALIB information is populated and ready.
    [3:0] PRECALIBRDY
      0=Ready (Precalibration information is populated and ready.); 15=NotReady (Precalibration information is not populated or ready.)
  0x04 INFO group — Unspecified
    {0x8+4k} ADDRESS[{k}] (k=0..58) ro reset 0xFFFFFFFF — Description collection: Address to trim register
    {0x10C+4k} DATA[{k}] (k=0..58) ro reset 0xFFFFFFFF — Description collection: Data for trim register
{0x700+0x4C*i} MRAM[{i}] (i=0..1) group — Unspecified
  0x00 LOWAVGCURR group — Unspecified
    0x00 READ ro reset 0xFFFFFFFF — Description cluster: Timeout value for low average current in case of read.
      [31:0] VALUE
    0x04 WRITE ro reset 0xFFFFFFFF — Description cluster: Timeout value for low average current in case of write.
      [31:0] VALUE
    0x08 ERASE ro reset 0xFFFFFFFF — Description cluster: Timeout value for low average current in case of erase.
      [31:0] VALUE
  0x0C WAITSTATES ro reset 0xFFFFFFFF — Description cluster: Default MRAM[n] waitstates.
    [31:0] VALUE
  0x10 READYNEXTTIMEOUT ro reset 0xFFFFFFFF — Description cluster: Default MRAM[n] READYNEXTTIMEOUT.
    [31:0] VALUE
  0x14 TRIMRDY ro reset 0xFFFFFFFF — Description cluster: MRAM TRIM information is populated and ready.
    [0] TRIMRDY — MRAM TRIM information is populated and ready.
      0=Ready (Trim information is populated and ready.); 1=NotReady (Trim information is not populated or ready.)
  0x18 NCONFIG ro reset 0xFFFFFFFF — Description cluster: Number of bits to load from trim configuration for MRAM[n].
    [31:0] VALUE
  {0x1C+4j} CONFIG[{j}] (j=0..11) ro reset 0xFFFFFFFF — Description collection: MRAM[n] trim configuration.
    [31:0] CONFIG — Trim Configuration [o].
0x1000 FWPATCH group — Unspecified
  {0x0+4j} PATCHADDR[{j}] (j=0..255) ro reset 0xFFFFFFFF — Description collection: Patch address for patch entry point n.
    [31:0] ADDR — Address
  {0x400+4j} TRAPADDR[{j}] (j=0..7) ro reset 0xFFFFFFFF — Description collection: Addresses in the ROM code which will be trapped to the PATCHADDR target.
    [31:0] VALUE
  {0x420+4j} PATCHCODE[{j}] (j=0..2807) ro reset 0xFFFFFFFF — Description collection: Patch code area.
    [31:0] DATA

## Notices in the file
Copyright (c) 2010 - 2022, Nordic Semiconductor ASA
All rights reserved.
Redistribution and use in source and binary forms, with or without modification,
are permitted provided that the following conditions are met:
1. Redistributions of source code must retain the above copyright notice, this
list of conditions and the following disclaimer.
2. Redistributions in binary form, except as embedded into a Nordic
Semiconductor ASA integrated circuit in a product or a software update for
such product, must reproduce the above copyright notice, this list of
conditions and the following disclaimer in the documentation and/or other
materials provided with the distribution.
3. Neither the name of Nordic Semiconductor ASA nor the names of its
contributors may be used to endorse or promote products derived from this
software without specific prior written permission.
4. This software, with or without modification, must only be used with a
Nordic Semiconductor ASA integrated circuit.
5. Any software provided in binary form under this license must not be reverse
engineered, decompiled, modified and/or disassembled.
THIS SOFTWARE IS PROVIDED BY NORDIC SEMICONDUCTOR ASA "AS IS" AND ANY EXPRESS
OR IMPLIED WARRANTIES, INCLUDING, BUT NOT LIMITED TO, THE IMPLIED WARRANTIES
OF MERCHANTABILITY, NONINFRINGEMENT, AND FITNESS FOR A PARTICULAR PURPOSE ARE
DISCLAIMED. IN NO EVENT SHALL NORDIC SEMICONDUCTOR ASA OR CONTRIBUTORS BE
LIABLE FOR ANY DIRECT, INDIRECT, INCIDENTAL, SPECIAL, EXEMPLARY, OR
CONSEQUENTIAL DAMAGES (INCLUDING, BUT NOT LIMITED TO, PROCUREMENT OF SUBSTITUTE
GOODS OR SERVICES; LOSS OF USE, DATA, OR PROFITS; OR BUSINESS INTERRUPTION)
HOWEVER CAUSED AND ON ANY THEORY OF LIABILITY, WHETHER IN CONTRACT, STRICT
LIABILITY, OR TORT (INCLUDING NEGLIGENCE OR OTHERWISE) ARISING IN ANY WAY OUT
OF THE USE OF THIS SOFTWARE, EVEN IF ADVISED OF THE POSSIBILITY OF SUCH DAMAGE.
