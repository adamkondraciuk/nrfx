# haltium_secure register map
Vendor: Nordic Semiconductor; Series: nRFHaltium; File version: 1
CPU: CM33 r0p4, little endian, MPU, FPU, 3 interrupt priority bits, 480 interrupts
Registers are 32-bit, read-write, reset 0x0 unless marked. A register's access mark holds for its fields unless they carry their own. Offsets are from the block's base; [hi:lo] are bit positions; lines under a group give offsets from that group; {n}, {i} and the like mark numbered series; 'fields as' and 'values as' point back to an identical list.

## SICR_S — Secure Information Configuration Registers
Base 0x0E000000
0x00 IROT group — Information on immutable Root of Trust.
  {0x0+4j} SYSROM[{j}] (j=0..3) — Description collection: 128-bit revision of SysCtrl ROM.
    [0] VALUE — nth word of the revision.
  {0x10+4j} SECROM[{j}] (j=0..3) — Description collection: 128-bit revision of Secure ROM.
    [0] VALUE — nth word of the revision.
  {0x20+4j} DEVICEID[{j}] (j=0..3) — Description collection: 128-bit Device Id.
    [0] UUID — Device UUID [n]. The DEVICE.UUID[0] contains the least significant bits of the device identifier.
  {0x30+4j} UCODE[{j}] (j=0..3) — Description collection: 128-bit revision of the CRACEN uCode.
    [0] VALUE — nth word of the revision.
  0x40 LCS1 group — LCS reported here shall be indentical to the oe in LCS2.
    0x00 LCS — The device lifecycle state as determined by the secure domain ROM code.
      [31:0] STATE — The device lifecycle state.
        0xFFFFFFFF=fff (LCS is Fresh From Fab, allowed only at a Nordic factory.); 1=Test (LCS is Test, allowed only at a Nordic factory.); 2=Empty (LCS is Empty, device assets installed in this state.); 3=RoT (Updatable RoT is installed and is verified by the immutable RoT.); 4=Deployed (Similar to LCS RoT, with device certificate installed.); 5=Analysis (This LCS is intended for field returns and the device cannot be deployed ever again.); 6=Discarded (The device assets are wiped and the device is retired from service.)
  0x44 LCS2 group — LCS reported here shall be indentical to the oe in LCS1.
    0x00 LCS — The device lifecycle state as determined by the secure domain ROM code.
      fields as IROT.LCS1.LCS
  0x50 BOOTSTATUS — Status of boot when the secure domain firmware starts execution, or the secure domain firmware is not started in LCS RoT and Deployed by secure domain ROM code.
    [0] STATUS — Status of boot.
0xF0 UROT group — Interface to store information related to the primary RoT.
  0x00 SM group — Signed Manifest verified by the Secure Domain ROM Code to establish the primary RoT.
    0x00 TBS group — Manifest describing the secure domain firmware. The secure domain ROM code verifies the signature on the digest of this register.
      0x00 PUBKEY group — ASN.1 DER encoded Public key used to verify the signed manifest.
        0x00 SIZE — The size of ASN.1 DER encoded public key (in bytes).
          [31:0] SIZE — Key size
            0xFFFFFFFF=Unprogrammed (The key is not programmed.); 35=Ed25519Size (The size of ASN.1 DER encoded ED25519 public key. Currently this is the only size supported by the secure domain ROM code.)
        0x04 ADDR reset 0xFFFFFFFF — Address of the ASN.1 DER encoded public key.
          [31:0] ADDR — Public key address.
            0xFFFFFFFF=Unprogrammed (The key is not programmed.)
      0x08 FW group — FW verified by the secure domain ROM code.
        0x00 SIZE — The firmware size (in bytes).
          [31:0] SIZE — Firmware size
            0xFFFFFFFF=Unprogrammed (The FW is not programmed.)
        0x04 ADDR — Address of the firmware verified by the secure domain ROM code.
          [31:0] ADDR — Firmware address
            0xFFFFFFFF=Unprogrammed (The FW is not programmed.); 0xE003000=Partition0 (The FW is programmed in partition 0.); 0xE00B000=Partition1 (The FW is not programmed in partition 1.)
        {0x8+4m} DIGEST[{m}] (m=0..15) — Description collection: SHA2-512 digest of the firmware.
          [31:0] VALUE — SHA2-512 Digest value
            0xFFFFFFFF=Unprogrammed (The FW digest, and hence the FW is not programmed.)
        {0x48+4m} VERSION[{m}] (m=0..3) — Description collection: 128-bit revision of the firmware; can be left Unprogrammed.
          [0] VALUE — nth word of the version.
        0x58 TIMESTAMP — Timestamp of the firmware in Unix time used to prevent downgrade of firmware on firmware update.
          [31:0] VALUE — Unix-time timestamp of the firmware
            0xFFFFFFFF=Unprogrammed (The FW timestamp is not programmed.)
      0x64 POLICY group — Set various policies on related to the firmware verification and update.
        0x00 UPDATE — Enable or Disable firmware update.
          [31:0] ENABLE — Possible values for this register.
            0xFFFFFFFF=Unprogrammed (The policy is not programmed, hence any existing policy on update is left unchanged.); 0xC3965A5A=Enabled (Enable firmware update.); 0x47D13CA5=Disabled (Disable firmware update.)
        0x04 REVOKE — Configure key revocation policy.
          [31:0] ENABLE — Possible values for this register
            0xFFFFFFFF=Unprogrammed (The policy is not programmed, hence any existing policy on auto-revocation is left unchanged.); 0xC3965A5A=Enabled (Enable auto-revocation of keys.); 0x47D13CA5=Disabled (Disable auto-revocation of keys used to verify firmware.)
        0x08 DGPREV — Configure the downgrade prevention policy.
          [31:0] ENABLE — Possible values for this register
            0xFFFFFFFF=Unprogrammed (The policy is not programmed, hence any existing policy on downgrade prevention is unaltered.); 0x965AC35A=Enable downgrade protection on firmware update. If Enabled, the SICR.UROT.SM.TIMESTAMP register cannot be left Unprogrammed.; 0x47D13CA5=Disable downgrade protection on firmware updates. If Disabled, the SICR.UROT.SM.TIMESTAMP register shall be left Unprogrammed.
    0xF8 SIGNATURE group — Signature on the manifest defined in SICR.UROT.SM.TBS
      0x00 SIZE reset 0xFFFFFFFF — ASN.1 DER encoded signature size in bytes.
        [31:0] SIZE — Signature size
          0xFFFFFFFF=Unprogrammed (The signature is not programmed.); 128=Ed25519SigSize (Size of ASN.1 DER-encoded Ed25519 signature.); 128=MaxSize (Currently, the secure domain ROM code supports only Ed25519 signature scheme, and hence the MaxSize is the same as the Ed25519 signature size.)
      0x04 ADDR — Address of the signature on the firmware manifest.
        [31:0] ADDR — Signature address.
          0xFFFFFFFF=Unprogrammed (The signature is not programmed.)
  0x100 UPDATE group — Description of FW Updates, if any. In case, SICR.UROT.TBS.POLICY.UPDATE is set to Disabled, these registers are ignored by the secure domain ROM code.
    0x00 OPERATION — Command from the secure domain firmware to the secure domain ROM code.
      [31:0] OPCODE — Opcode to identify the command.
        0xFFFFFFFF=Nop (No operation pending.); 0x80000001=Verify (This commands allows the firmware update to just be verified without applying it.); 0x80000002=Activate (This indicates the firmware update shall be (verified and) applied.); 0x8F9AC403=Confirm (The update image is expected to set this operation to indicate it booted correctly.)
    0x04 STATUS — ROM code indicates the status of update to the secure domain firmware via this register.
      [31:0] CODE — Status code.
        0xFFFFFFFF=None (No operation pending to indicate any status.); 0xF0000001=UnknownOperation (Unknown OPCODE in SICR.UROT.UPDATE.OPERATION.); 0xF0000002=InvalidManifest (The information in the manifest is invalid.); 0xF0000003=InvalidSignature (The signature did not verify.); 0xF0000004=UnknownPubKey (The public key in SICR.UROT.UPDATE.SM.TBS.PUBKEY is unknown.); 0xF0000005=RevokedPubKey (The public key used to signature is already revoked on the device.); 0xF0000006=StaleFW (The timestamp on the firmware is older than the current one.); 0xF0000007=VerifyOK (Signature verification is successful.); 0xF0000008=InvalidPartition (The firmware update is built for the wrong partion. Any update that overwrites the existing firmware is disallowed.); 0xF0000009=Unconfirmed (The firmware update is applied, but is pending confirmation from the updated firmware.); 0xF000000A=NothingPending (The firmware update is confirmed to work, the update is the same as the current firmware, hence nothing to update.); 0xF000000A=Reverted (The secure domain ROM code reverted the update as the update is not confirmed.)
    0x08 DOWNLOADADDR — Location for the downloaded firmware update.
      [0] ADDR — MRAM Location for the downloaded firmware update.
    0x10 SM group — Signed Manifest verified by the Secure Domain ROM Code to establish the primary RoT.
      0x00 TBS group — Manifest describing the secure domain firmware. The secure domain ROM code verifies the signature on the digest of this register.
        0x00 PUBKEY group — ASN.1 DER encoded Public key used to verify the signed manifest.
          0x00 SIZE — The size of ASN.1 DER encoded public key (in bytes).
            fields as UROT.SM.TBS.PUBKEY.SIZE
          0x04 ADDR reset 0xFFFFFFFF — Address of the ASN.1 DER encoded public key.
            fields as UROT.SM.TBS.PUBKEY.ADDR
        0x08 FW group — FW verified by the secure domain ROM code.
          0x00 SIZE — The firmware size (in bytes).
            fields as UROT.SM.TBS.FW.SIZE
          0x04 ADDR — Address of the firmware verified by the secure domain ROM code.
            fields as UROT.SM.TBS.FW.ADDR
          {0x8+4p} DIGEST[{p}] (p=0..15) — Description collection: SHA2-512 digest of the firmware.
            fields as UROT.SM.TBS.FW.DIGEST[0]
          {0x48+4p} VERSION[{p}] (p=0..3) — Description collection: 128-bit revision of the firmware; can be left Unprogrammed.
            [0] VALUE — nth word of the version.
          0x58 TIMESTAMP — Timestamp of the firmware in Unix time used to prevent downgrade of firmware on firmware update.
            fields as UROT.SM.TBS.FW.TIMESTAMP
        0x64 POLICY group — Set various policies on related to the firmware verification and update.
          0x00 UPDATE — Enable or Disable firmware update.
            fields as UROT.SM.TBS.POLICY.UPDATE
          0x04 REVOKE — Configure key revocation policy.
            fields as UROT.SM.TBS.POLICY.REVOKE
          0x08 DGPREV — Configure the downgrade prevention policy.
            fields as UROT.SM.TBS.POLICY.DGPREV
      0xF8 SIGNATURE group — Signature on the manifest defined in SICR.UROT.SM.TBS
        0x00 SIZE reset 0xFFFFFFFF — ASN.1 DER encoded signature size in bytes.
          fields as UROT.SM.SIGNATURE.SIZE
        0x04 ADDR — Address of the signature on the firmware manifest.
          fields as UROT.SM.SIGNATURE.ADDR
  {0x210+4j} CERTIFICATE[{j}] (j=0..1023) — Description collection: Device X.509 certificate.
    [0] CERT — Device certificate.
0x1300 AROT group — Interface used by the secure domain firmware to extend the RoT to the other local domains and store information on configuration of debug access ports, CTRL-AP methods, and other platfrom security related configurations per domain. These registers are only accessed the secure domain firmware. Any operations related to the local domains must be requested via the secure domain firmware API.
  0x00 SECURE group — Any next-stage secure domain firmware related.
    0x00 TBD ro — To be added once the secure domain ROM-related interface is agreed.
  0x400 APPLICATION group — Extended RoT to the application core/domain.
    0x00 TBD ro — To be added once the secure domain ROM-related interface is agreed.
  0x800 RADIO group — Interface to extend the RoT to the radio core/domain.
    0x00 TBD ro — To be added once the secure domain ROM-related interface is agreed.
  0xC00 CELLULARCORE group — Interface to extend the RoT to the cellular core/domain.
    0x00 TBD ro — To be added once the secure domain ROM-related interface is agreed.

## Notices in the file
Copyright (c) 2010 - 2021, Nordic Semiconductor ASA
All rights reserved.
Redistribution and use in source and binary forms, with or without modification,
are permitted provided that the following conditions are met:
1. Redistributions of source code must retain the above copyright notice, this
list of conditions and the following disclaimer.
2. Redistributions in binary form, except as embedded into a Nordic
Semiconductor ASA integrated circuit in a product or a software update for
such product, must reproduce the above copyright notice, this list of
conditions and the following disclaimer in the documentation and/or other
materials provided with the distribution.
3. Neither the name of Nordic Semiconductor ASA nor the names of its
contributors may be used to endorse or promote products derived from this
software without specific prior written permission.
4. This software, with or without modification, must only be used with a
Nordic Semiconductor ASA integrated circuit.
5. Any software provided in binary form under this license must not be reverse
engineered, decompiled, modified and/or disassembled.
THIS SOFTWARE IS PROVIDED BY NORDIC SEMICONDUCTOR ASA "AS IS" AND ANY EXPRESS
OR IMPLIED WARRANTIES, INCLUDING, BUT NOT LIMITED TO, THE IMPLIED WARRANTIES
OF MERCHANTABILITY, NONINFRINGEMENT, AND FITNESS FOR A PARTICULAR PURPOSE ARE
DISCLAIMED. IN NO EVENT SHALL NORDIC SEMICONDUCTOR ASA OR CONTRIBUTORS BE
LIABLE FOR ANY DIRECT, INDIRECT, INCIDENTAL, SPECIAL, EXEMPLARY, OR
CONSEQUENTIAL DAMAGES (INCLUDING, BUT NOT LIMITED TO, PROCUREMENT OF SUBSTITUTE
GOODS OR SERVICES; LOSS OF USE, DATA, OR PROFITS; OR BUSINESS INTERRUPTION)
HOWEVER CAUSED AND ON ANY THEORY OF LIABILITY, WHETHER IN CONTRACT, STRICT
LIABILITY, OR TORT (INCLUDING NEGLIGENCE OR OTHERWISE) ARISING IN ANY WAY OUT
OF THE USE OF THIS SOFTWARE, EVEN IF ADVISED OF THE POSSIBILITY OF SUCH DAMAGE.
