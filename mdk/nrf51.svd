# nrf51 register map
Vendor: Nordic Semiconductor; Series: nrf51; File version: 522
nRF51 reference description for radio MCU with ARM 32-bit Cortex-M0 Microcontroller at 16MHz CPU clock
CPU: CM0 r3p1, little endian, no MPU, no FPU, 2 interrupt priority bits
Registers are 32-bit, read-write, reset 0x0 unless marked. A register's access mark holds for its fields unless they carry their own. Offsets are from the block's base; lines under a group give offsets from that group; [hi:lo] are bit positions; {n}, {i} and the like mark numbered series; 'fields as' and 'values as' point back to an identical list; <NAME> marks a mode.

## Memory map
0x10000000 FICR size 0x1000 — Factory Information Configuration.
0x10001000 UICR size 0x1000 — User Information Configuration.
0x40000000 POWER size 0x1000 — Power Control.
0x40000000 CLOCK size 0x1000 — Clock control.
0x40000000 MPU size 0x1000 — Memory Protection Unit.
0x40001000 RADIO size 0x1000 — The radio.
0x40002000 UART0 size 0x1000 — Universal Asynchronous Receiver/Transmitter.
0x40003000 SPI0 size 0x1000 — SPI master 0.
0x40003000 TWI0 size 0x1000 — Two-wire interface master 0.
0x40004000 SPI1 size 0x1000 — SPI master 1.
0x40004000 TWI1 size 0x1000 — Two-wire interface master 1.
0x40004000 SPIS1 size 0x1000 — SPI slave 1.
0x40006000 GPIOTE size 0x1000 — GPIO tasks and events.
0x40007000 ADC size 0x1000 — Analog to digital converter.
0x40008000 TIMER0 size 0x1000
0x40009000 TIMER1 size 0x1000
0x4000A000 TIMER2 size 0x1000
0x4000B000 RTC0 size 0x1000 — Real time counter 0.
0x4000C000 TEMP size 0x1000 — Temperature Sensor.
0x4000D000 RNG size 0x1000 — Random Number Generator.
0x4000E000 ECB size 0x1000 — AES ECB Mode Encryption.
0x4000F000 AAR size 0x1000 — Accelerated Address Resolver.
0x4000F000 CCM size 0x1000 — AES CCM Mode Encryption.
0x40010000 WDT size 0x1000 — Watchdog Timer.
0x40011000 RTC1 size 0x1000 — Real time counter 1.
0x40012000 QDEC size 0x1000 — Rotary decoder.
0x40013000 LPCOMP size 0x1000 — Low power comparator.
0x40014000 SWI size 0x6000 — SW Interrupts.
0x4001E000 NVMC size 0x1000 — Non Volatile Memory Controller.
0x4001F000 PPI size 0x1000 — PPI controller.
0x50000000 GPIO size 0x1000 — General purpose input and output.

## Interrupts
0 POWER_CLOCK (POWER, CLOCK)
1 RADIO
2 UART0
3 SPI0_TWI0 (SPI0, TWI0)
4 SPI1_TWI1 (SPI1, TWI1, SPIS1)
6 GPIOTE
7 ADC
8 TIMER0
9 TIMER1
10 TIMER2
11 RTC0
12 TEMP
13 RNG
14 ECB
15 CCM_AAR (AAR, CCM)
16 WDT
17 RTC1
18 QDEC
19 LPCOMP
20 SWI0 (SWI)
21 SWI1 (SWI)
22 SWI2 (SWI)
23 SWI3 (SWI)
24 SWI4 (SWI)
25 SWI5 (SWI)

## Further device data
ExampleStackSize=2048, ExampleHeapSize=2048, MaxInterrupts=32

## Licence text in the file
Copyright (c) 2010 - 2023, Nordic Semiconductor ASA . All rights reserved. . Redistribution and use in source and binary forms, with or without modification, are permitted provided that the following conditions are met: . 1. Redistributions of source code must retain the above copyright notice, this list of conditions and the following disclaimer. . 2. Redistributions in binary form, except as embedded into a Nordic. Semiconductor ASA integrated circuit in a product or a software update for such product, must reproduce the above copyright notice, this list of conditions and the following disclaimer in the documentation and/or other materials provided with the distribution. . 3. Neither the name of Nordic Semiconductor ASA nor the names of its contributors may be used to endorse or promote products derived from this software without specific prior written permission. . 4. This software, with or without modification, must only be used with a. Nordic Semiconductor ASA integrated circuit. . 5. Any software provided in binary form under this license must not be reverse engineered, decompiled, modified and/or disassembled. . THIS SOFTWARE IS PROVIDED BY NORDIC SEMICONDUCTOR ASA "AS IS" AND ANY EXPRESS. OR IMPLIED WARRANTIES, INCLUDING, BUT NOT LIMITED TO, THE IMPLIED WARRANTIES. OF MERCHANTABILITY, NONINFRINGEMENT, AND FITNESS FOR A PARTICULAR PURPOSE ARE. DISCLAIMED. IN NO EVENT SHALL NORDIC SEMICONDUCTOR ASA OR CONTRIBUTORS BE. LIABLE FOR ANY DIRECT, INDIRECT, INCIDENTAL, SPECIAL, EXEMPLARY, OR. CONSEQUENTIAL DAMAGES (INCLUDING, BUT NOT LIMITED TO, PROCUREMENT OF SUBSTITUTE. GOODS OR SERVICES; LOSS OF USE, DATA, OR PROFITS; OR BUSINESS INTERRUPTION). HOWEVER CAUSED AND ON ANY THEORY OF LIABILITY, WHETHER IN CONTRACT, STRICT. LIABILITY, OR TORT (INCLUDING NEGLIGENCE OR OTHERWISE) ARISING IN ANY WAY OUT. OF THE USE OF THIS SOFTWARE, EVEN IF ADVISED OF THE POSSIBILITY OF SUCH DAMAGE.
