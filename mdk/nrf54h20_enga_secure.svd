# nrf54h20_enga_secure register map
Vendor: Nordic Semiconductor; Series: nRF54h; File version: 1
CPU: CM33 r0p4, little endian, MPU, no FPU, 3 interrupt priority bits, 480 interrupts, 4 SAU regions
Registers are 32-bit, read-write, reset 0x0 unless marked. A register's access mark holds for its fields unless they carry their own. Offsets are from the block's base; [hi:lo] are bit positions; lines under a group give offsets from that group; {n}, {i} and the like mark numbered series; 'fields as' and 'values as' point back to an identical list.

## RICR_S — ROM Information Configuration Registers
Base 0x0FFFC000
0x00 LCS group — Unspecified
  {0x0+4j} SIGNATURE[{j}] (j=0..3) reset 0xFFFFFFFF — Description collection: Signature to determine the re-entrant device life-cycle state (LCS).
    [31:0] VALUE — Uninitialized when freshly out of factory, esle PUF-derived LCS signature.
      0xFFFFFFFF=UNINITIALIZED (Value of LCS registers when the device is freshly manufactured (LCS state FFF), and the MRAM and the info pages including RICR are uninitialized.)
0x10 UROT group — Unspecified
  0x00 SM group — Signed Manifest verified by the Secure Domain ROM Code to establish the primary RoT.
    0x00 TBS group — Manifest describing the secure domain firmware. The secure domain ROM code verifies the signature on the digest of this register.
      0x00 PUBKEY group — Raw public key used to verify the signed manifest.
        0x00 SIZE — The size of the raw public key(in bytes).
          [31:0] SIZE — Key size
            0xFFFFFFFF=Unprogrammed (The key is not programmed.); 32=SizeEd25519 (The size of the raw Ed25519 public key. Currently this is the only size supported by the secure domain ROM code.)
        0x04 ADDR — Address of the raw public key.
          [31:0] ADDR — Public key address.
            0xFFFFFFFF=Unprogrammed (The key is not programmed.)
      0x08 LAYOUT group — The MRAM layout of UROT firmware and the recovery image.
        0x00 USLOT group — Start adddress and max size of UROT slot (USLOT), Shall remain the same for firmware updates once programmed or unless transitioned back to LCS Empty.
          0x00 START — Start address of the UROT firmware. Shall not overlap with the recovery slot (RSLOT).
            [31:0] ADDR
              0xFFFFFFFF=Undefined (The slot is not defined.)
          0x04 MAX — Maximum size of the UROT firmware in bytes.
            [31:0] SIZE
              0xFFFFFFFF=Undefined (The slot is not defined.)
        0x08 RSLOT group — Start adddress and max size of recovery slot (RSLOT), Shall remain the same for firmware updates once programmed or unless transitioned back to LCS Empty.
          0x00 START — Start address of the recovery firmware. Shall not overlap with the UROT slot(USLOT).
            [31:0] ADDR
              0xFFFFFFFF=Undefined (The slot is not defined.)
          0x04 MAX — Maximum size of the recovery image in bytes.
            [31:0] SIZE
              0xFFFFFFFF=Undefined (The slot is not defined.)
      0x18 FW group — FW verified by the secure domain ROM code.
        0x00 SIZE — The firmware size (in bytes). Shall not exceed the max defined limits for USLOT in case of UROT firmware.Shall not exceed the max defined limits for USLOT in case of UROT firmware.
          [31:0] SIZE — Firmware size
            0xFFFFFFFF=Unprogrammed (The FW is not programmed.)
        0x04 ADDR — Address of the firmware verified by the secure domain ROM code.
          [31:0] ADDR — Firmware address
            0xFFFFFFFF=Unprogrammed (The FW is not programmed.)
        {0x8+4m} DIGEST[{m}] (m=0..15) — Description collection: SHA2-512 digest of the firmware.
          [31:0] VALUE — SHA2-512 Digest value
            0xFFFFFFFF=Unprogrammed (The FW digest, and hence the FW is not programmed.)
        {0x48+4m} VERSION[{m}] (m=0..3) — Description collection: 128-bit revision of the firmware; can be left Unprogrammed.
          [0] VALUE — nth word of the version.
        0x58 TIMESTAMP — Timestamp of the firmware in Unix time used to prevent downgrade of firmware on firmware update.
          [31:0] VALUE — Unix-time timestamp of the firmware
            0xFFFFFFFF=Unprogrammed (The FW timestamp is not programmed.)
      0x74 POLICY group — Set various policies on related to the firmware verification and update.
        0x00 UPDATE — Enable or Disable firmware update.
          [31:0] ENABLE — Possible values for this register.
            0xFFFFFFFF=Unprogrammed (The policy is not programmed, hence any existing policy on update is left unchanged.); 0xC3965A5A=Enabled (Enable firmware update.); 0x47D13CA5=Disabled (Disable firmware update.)
        0x04 REVOKE — Configure key revocation policy.
          [31:0] ENABLE — Possible values for this register
            0xFFFFFFFF=Unprogrammed (The policy is not programmed, hence any existing policy on auto-revocation is left unchanged.); 0xC3965A5A=Enabled (Enable auto-revocation of keys.); 0x47D13CA5=Disabled (Disable auto-revocation of keys used to verify firmware.)
        0x08 DGPREV — Configure the downgrade prevention policy.
          [31:0] ENABLE — Possible values for this register
            0xFFFFFFFF=Unprogrammed (The policy is not programmed, hence any existing policy on downgrade prevention is unaltered.); 0xC3965A5A=Enable downgrade protection on firmware update. If Enabled, the SICR.UROT.SM.TIMESTAMP register cannot be left Unprogrammed.; 0x47D13CA5=Disable downgrade protection on firmware updates. If Disabled, the SICR.UROT.SM.TIMESTAMP register shall be left Unprogrammed.
        {0xC+4m} RFU[{m}] (m=0..28) — Description collection: These registers are included when generating signature of the TBS content of SICR.
    0xF4 SIGNATURE group — Signature on the manifest defined in SICR.UROT.SM.TBS
      0x00 ALG — The signature algorithm identifier as defined in RFC8152.
        [31:0] ID — Algorithm identifier
          0xFFFFFFFF=Unprogrammed (The signature algorithm identifier is not programmed.); 5=AlgIdEd25519 (ARM ADAC-defined identifier for Ed25519. The use of ARM ADAC-defined identifier ensures consistent user interface on CTRL-AP and SICR. Only Ed25519 curve is supported.)
      0x04 SIZE — Size of the raw signature in bytes.
        [31:0] SIZE — Signature size
          0xFFFFFFFF=Unprogrammed (The signature is not programmed.); 64=SizeEd25519 (Size of Ed25519 signature bytestring.); 64=MaxSize (Currently, the secure domain ROM code supports only Ed25519 (and only Ed25519 curve) signature scheme, and hence the MaxSize is the same as the Ed25519 signature size.)
      0x08 ADDR — Address of the signature on the firmware manifest.
        [31:0] ADDR — Signature address.
          0xFFFFFFFF=Unprogrammed (The signature is not programmed.)
  0x100 RECOVERY group — Unspecified
    0x00 SM group — Signed Manifest verified by the Secure Domain ROM Code to establish the primary RoT.
      0x00 TBS group — Manifest describing the secure domain firmware. The secure domain ROM code verifies the signature on the digest of this register.
        0x00 PUBKEY group — Raw public key used to verify the signed manifest.
          0x00 SIZE — The size of the raw public key(in bytes).
            fields as UROT.SM.TBS.PUBKEY.SIZE
          0x04 ADDR — Address of the raw public key.
            fields as UROT.SM.TBS.PUBKEY.ADDR
        0x08 LAYOUT group — The MRAM layout of UROT firmware and the recovery image.
          0x00 USLOT group — Start adddress and max size of UROT slot (USLOT), Shall remain the same for firmware updates once programmed or unless transitioned back to LCS Empty.
            0x00 START — Start address of the UROT firmware. Shall not overlap with the recovery slot (RSLOT).
              [31:0] ADDR
                0xFFFFFFFF=Undefined (The slot is not defined.)
            0x04 MAX — Maximum size of the UROT firmware in bytes.
              [31:0] SIZE
                0xFFFFFFFF=Undefined (The slot is not defined.)
          0x08 RSLOT group — Start adddress and max size of recovery slot (RSLOT), Shall remain the same for firmware updates once programmed or unless transitioned back to LCS Empty.
            0x00 START — Start address of the recovery firmware. Shall not overlap with the UROT slot(USLOT).
              [31:0] ADDR
                0xFFFFFFFF=Undefined (The slot is not defined.)
            0x04 MAX — Maximum size of the recovery image in bytes.
              [31:0] SIZE
                0xFFFFFFFF=Undefined (The slot is not defined.)
        0x18 FW group — FW verified by the secure domain ROM code.
          0x00 SIZE — The firmware size (in bytes). Shall not exceed the max defined limits for USLOT in case of UROT firmware.Shall not exceed the max defined limits for USLOT in case of UROT firmware.
            fields as UROT.SM.TBS.FW.SIZE
          0x04 ADDR — Address of the firmware verified by the secure domain ROM code.
            fields as UROT.SM.TBS.FW.ADDR
          {0x8+4p} DIGEST[{p}] (p=0..15) — Description collection: SHA2-512 digest of the firmware.
            fields as UROT.SM.TBS.FW.DIGEST[0]
          {0x48+4p} VERSION[{p}] (p=0..3) — Description collection: 128-bit revision of the firmware; can be left Unprogrammed.
            [0] VALUE — nth word of the version.
          0x58 TIMESTAMP — Timestamp of the firmware in Unix time used to prevent downgrade of firmware on firmware update.
            fields as UROT.SM.TBS.FW.TIMESTAMP
        0x74 POLICY group — Set various policies on related to the firmware verification and update.
          0x00 UPDATE — Enable or Disable firmware update.
            fields as UROT.SM.TBS.POLICY.UPDATE
          0x04 REVOKE — Configure key revocation policy.
            fields as UROT.SM.TBS.POLICY.REVOKE
          0x08 DGPREV — Configure the downgrade prevention policy.
            fields as UROT.SM.TBS.POLICY.DGPREV
          {0xC+4p} RFU[{p}] (p=0..28) — Description collection: These registers are included when generating signature of the TBS content of SICR.
      0xF4 SIGNATURE group — Signature on the manifest defined in SICR.UROT.SM.TBS
        0x00 ALG — The signature algorithm identifier as defined in RFC8152.
          fields as UROT.SM.SIGNATURE.ALG
        0x04 SIZE — Size of the raw signature in bytes.
          fields as UROT.SM.SIGNATURE.SIZE
        0x08 ADDR — Address of the signature on the firmware manifest.
          fields as UROT.SM.SIGNATURE.ADDR
  0x200 UPDATE group — Internal information maintained by the secure domain ROM code on the state of update.
    0x00 STATUS — ROM code maintains the status of update here.
      [31:0] CODE — Status code.
        0xFFFFFFFF=None (No operation pending to indicate any status.); 0xF0000009=UROTUnconfirmed (The firmware update is applied, but is pending confirmation from the updated firmware.); 0xF000000A=RecoveryUnconfirmed (The firmware update is applied, but is pending confirmation from the updated firmware.); 0xF000000C=SafeMode (Recovery image is booted in safe mode as the UROT firmware update failed and the ROM could not restore any previous UROT firmware.); 0xF000000D=AROTRecovery (Recovery image is booted so that the recovery image can download a AROT image that ROM does not verify.); 0xF000000E=UROTUpdateDisabled (No valid recovery image is present and hence UROT firmware update is disabled.)

## Notices in the file
Copyright (c) 2010 - 2024, Nordic Semiconductor ASA
All rights reserved.
Redistribution and use in source and binary forms, with or without modification,
are permitted provided that the following conditions are met:
1. Redistributions of source code must retain the above copyright notice, this
list of conditions and the following disclaimer.
2. Redistributions in binary form, except as embedded into a Nordic
Semiconductor ASA integrated circuit in a product or a software update for
such product, must reproduce the above copyright notice, this list of
conditions and the following disclaimer in the documentation and/or other
materials provided with the distribution.
3. Neither the name of Nordic Semiconductor ASA nor the names of its
contributors may be used to endorse or promote products derived from this
software without specific prior written permission.
4. This software, with or without modification, must only be used with a
Nordic Semiconductor ASA integrated circuit.
5. Any software provided in binary form under this license must not be reverse
engineered, decompiled, modified and/or disassembled.
THIS SOFTWARE IS PROVIDED BY NORDIC SEMICONDUCTOR ASA "AS IS" AND ANY EXPRESS
OR IMPLIED WARRANTIES, INCLUDING, BUT NOT LIMITED TO, THE IMPLIED WARRANTIES
OF MERCHANTABILITY, NONINFRINGEMENT, AND FITNESS FOR A PARTICULAR PURPOSE ARE
DISCLAIMED. IN NO EVENT SHALL NORDIC SEMICONDUCTOR ASA OR CONTRIBUTORS BE
LIABLE FOR ANY DIRECT, INDIRECT, INCIDENTAL, SPECIAL, EXEMPLARY, OR
CONSEQUENTIAL DAMAGES (INCLUDING, BUT NOT LIMITED TO, PROCUREMENT OF SUBSTITUTE
GOODS OR SERVICES; LOSS OF USE, DATA, OR PROFITS; OR BUSINESS INTERRUPTION)
HOWEVER CAUSED AND ON ANY THEORY OF LIABILITY, WHETHER IN CONTRACT, STRICT
LIABILITY, OR TORT (INCLUDING NEGLIGENCE OR OTHERWISE) ARISING IN ANY WAY OUT
OF THE USE OF THIS SOFTWARE, EVEN IF ADVISED OF THE POSSIBILITY OF SUCH DAMAGE.
