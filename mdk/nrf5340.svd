# nrf5340 register map
Vendor: Nordic Semiconductor; Series: nrf53; File version: 1
nRF53 reference description for radio MCU with ARM 32-bit Cortex-M33 Microcontroller
CPU: CM33 r0p2, little endian, MPU, FPU, 3 interrupt priority bits
Registers are 32-bit, read-write, reset 0x0 unless marked. A register's access mark holds for its fields unless they carry their own. Offsets are from the block's base; lines under a group give offsets from that group; [hi:lo] are bit positions; {n}, {i} and the like mark numbered series; 'fields as' and 'values as' point back to an identical list; <NAME> marks a mode.

## Memory map
0x00FF0000 FICR_NS size 0x1000 — Factory Information Configuration Registers 0
0x00FF0000 FICR_S size 0x1000 — Factory Information Configuration Registers 1
0x00FF8000 UICR_S size 0x1000 — User Information Configuration Registers User Information Configuration Registers
0x40000000 AMLI_NS size 0x1000 — AHB Multi-Layer Interface 0
0x40000000 DCNF_NS size 0x1000 — Domain Configuration Management 0
0x40004000 OSCILLATORS_NS size 0x1000 — Oscillator control 0
0x40004000 REGULATORS_NS size 0x1000 — Voltage regulators 0
0x40005000 CLOCK_NS size 0x1000 — Clock Management 0
0x40005000 POWER_NS size 0x1000 — Power Control 0
0x40005000 RESET_NS size 0x1000 — Reset Control 0
0x40006000 CTRLAP_NS size 0x1000 — Control access port 0
0x40007000 PAMLI_NS size 0x1000 — Peripheral AHB Multi-Layer Interface 0
0x40008000 SPIM0_NS size 0x1000 — Serial Peripheral Interface Master with EasyDMA 0
0x40008000 SPIS0_NS size 0x1000 — SPI Slave 0
0x40008000 TWIM0_NS size 0x1000 — I2C compatible Two-Wire Master Interface with EasyDMA 0
0x40008000 TWIS0_NS size 0x1000 — I2C compatible Two-Wire Slave Interface with EasyDMA 0
0x40008000 UARTE0_NS size 0x1000 — UART with EasyDMA 0
0x40009000 SPIM1_NS size 0x1000 — Serial Peripheral Interface Master with EasyDMA 2
0x40009000 SPIS1_NS size 0x1000 — SPI Slave 2
0x40009000 TWIM1_NS size 0x1000 — I2C compatible Two-Wire Master Interface with EasyDMA 2
0x40009000 TWIS1_NS size 0x1000 — I2C compatible Two-Wire Slave Interface with EasyDMA 2
0x40009000 UARTE1_NS size 0x1000 — UART with EasyDMA 2
0x4000A000 SPIM2_NS size 0x1000 — Serial Peripheral Interface Master with EasyDMA 4
0x4000E000 SAADC_NS size 0x1000 — Analog to Digital Converter 0
0x4000F000 TIMER0_NS size 0x1000 — Timer/Counter 0
0x40010000 TIMER1_NS size 0x1000 — Timer/Counter 2
0x40011000 TIMER2_NS size 0x1000 — Timer/Counter 4
0x40014000 RTC0_NS size 0x1000 — Real time counter 0
0x40015000 RTC1_NS size 0x1000 — Real time counter 2
0x40017000 DPPIC_NS size 0x1000 — Distributed Programmable Peripheral Interconnect Controller 0
0x40018000 WDT0_NS size 0x1000 — Watchdog Timer 0
0x40019000 WDT1_NS size 0x1000 — Watchdog Timer 2
0x4001A000 COMP_NS size 0x1000 — Comparator 0
0x4001A000 LPCOMP_NS size 0x1000 — Low Power Comparator 0
0x4001B000 EGU0_NS size 0x1000 — Event Generator Unit 0
0x4001C000 EGU1_NS size 0x1000 — Event Generator Unit 2
0x4001D000 EGU2_NS size 0x1000 — Event Generator Unit 4
0x4001E000 EGU3_NS size 0x1000 — Event Generator Unit 6
0x4001F000 EGU4_NS size 0x1000 — Event Generator Unit 8
0x40020000 EGU5_NS size 0x1000 — Event Generator Unit 10
0x40021000 PWM0_NS size 0x1000 — Pulse Width Modulation Unit 0
0x40022000 PWM1_NS size 0x1000 — Pulse Width Modulation Unit 2
0x40023000 PWM2_NS size 0x1000 — Pulse Width Modulation Unit 4
0x40026000 PDM0_NS size 0x1000 — Pulse Density Modulation (Digital Microphone) Interface 0
0x40028000 I2S0_NS size 0x1000 — Inter-IC Sound 0
0x4002A000 IPC_NS size 0x1000 — Inter Processor Communication 0
0x4002B000 QSPI_NS size 0x1000 — External flash interface 0
0x4002D000 NFCT_NS size 0x1000 — NFC-A compatible radio 0
0x4002E000 M2M_NS size 0x1000 — Memory to Memory DMA 0
0x40030000 MUTEX_NS size 0x1000 — MUTEX 0
0x40031000 GPIOTE_NS_NS size 0x1000 — GPIO Tasks and Events 1
0x40080000 NVMC_NS size 0x1000 — Non Volatile Memory Controller 0
0x40081000 VMC_NS size 0x1000 — Volatile Memory controller 0
0x408C0500 P0_NS size 0x300 — GPIO Port 0
0x408C0800 P1_NS size 0x300 — GPIO Port 1
0x50000000 AMLI_S size 0x1000 — AHB Multi-Layer Interface 1
0x50000000 DCNF_S size 0x1000 — Domain Configuration Management 1
0x50002000 PCGCMASTER_CM4SS_S size 0x1000 — PCGC Master 0
0x50003000 SPU_S size 0x1000 — System Protection Unit
0x50004000 OSCILLATORS_S size 0x1000 — Oscillator control 1
0x50004000 REGULATORS_S size 0x1000 — Voltage regulators 1
0x50005000 CLOCK_S size 0x1000 — Clock Management 1
0x50005000 POWER_S size 0x1000 — Power Control 1
0x50005000 RESET_S size 0x1000 — Reset Control 1
0x50006000 CTRLAP_S size 0x1000 — Control access port 1
0x50007000 PAMLI_S size 0x1000 — Peripheral AHB Multi-Layer Interface 1
0x50008000 SPIM0_S size 0x1000 — Serial Peripheral Interface Master with EasyDMA 1
0x50008000 SPIS0_S size 0x1000 — SPI Slave 1
0x50008000 TWIM0_S size 0x1000 — I2C compatible Two-Wire Master Interface with EasyDMA 1
0x50008000 TWIS0_S size 0x1000 — I2C compatible Two-Wire Slave Interface with EasyDMA 1
0x50008000 UARTE0_S size 0x1000 — UART with EasyDMA 1
0x50009000 SPIM1_S size 0x1000 — Serial Peripheral Interface Master with EasyDMA 3
0x50009000 SPIS1_S size 0x1000 — SPI Slave 3
0x50009000 TWIM1_S size 0x1000 — I2C compatible Two-Wire Master Interface with EasyDMA 3
0x50009000 TWIS1_S size 0x1000 — I2C compatible Two-Wire Slave Interface with EasyDMA 3
0x50009000 UARTE1_S size 0x1000 — UART with EasyDMA 3
0x5000A000 SPIM2_S size 0x1000 — Serial Peripheral Interface Master with EasyDMA 5
0x5000D000 GPIOTE_S_S size 0x1000 — GPIO Tasks and Events 0
0x5000E000 SAADC_S size 0x1000 — Analog to Digital Converter 1
0x5000F000 TIMER0_S size 0x1000 — Timer/Counter 1
0x50010000 TIMER1_S size 0x1000 — Timer/Counter 3
0x50011000 TIMER2_S size 0x1000 — Timer/Counter 5
0x50014000 RTC0_S size 0x1000 — Real time counter 1
0x50015000 RTC1_S size 0x1000 — Real time counter 3
0x50017000 DPPIC_S size 0x1000 — Distributed Programmable Peripheral Interconnect Controller 1
0x50018000 WDT0_S size 0x1000 — Watchdog Timer 1
0x50019000 WDT1_S size 0x1000 — Watchdog Timer 3
0x5001A000 COMP_S size 0x1000 — Comparator 1
0x5001A000 LPCOMP_S size 0x1000 — Low Power Comparator 1
0x5001B000 EGU0_S size 0x1000 — Event Generator Unit 1
0x5001C000 EGU1_S size 0x1000 — Event Generator Unit 3
0x5001D000 EGU2_S size 0x1000 — Event Generator Unit 5
0x5001E000 EGU3_S size 0x1000 — Event Generator Unit 7
0x5001F000 EGU4_S size 0x1000 — Event Generator Unit 9
0x50020000 EGU5_S size 0x1000 — Event Generator Unit 11
0x50021000 PWM0_S size 0x1000 — Pulse Width Modulation Unit 1
0x50022000 PWM1_S size 0x1000 — Pulse Width Modulation Unit 3
0x50023000 PWM2_S size 0x1000 — Pulse Width Modulation Unit 5
0x50026000 PDM0_S size 0x1000 — Pulse Density Modulation (Digital Microphone) Interface 1
0x50028000 I2S0_S size 0x1000 — Inter-IC Sound 1
0x5002A000 IPC_S size 0x1000 — Inter Processor Communication 1
0x5002B000 QSPI_S size 0x1000 — External flash interface 1
0x5002D000 NFCT_S size 0x1000 — NFC-A compatible radio 1
0x5002E000 M2M_S size 0x1000 — Memory to Memory DMA 1
0x50030000 MUTEX_S size 0x1000 — MUTEX 1
0x50080000 KMU_S size 0x1000 — Key Management Unit
0x50080000 NVMC_S size 0x1000 — Non Volatile Memory Controller 1
0x50081000 VMC_S size 0x1000 — Volatile Memory controller 1
0x500C0000 GPIOCONFIG_S size 0x1000 — PCGCSlave 0
0x50100000 PCGCMASTER_APPMAIN_S size 0x1000 — PCGC Master 1
0x50101000 PCGCMASTER_APPMCU_S size 0x1000 — PCGC Master 2
0x50102000 PCGCSLAVE0_S size 0x1000 — PCGCSlave 1
0x50104000 INFOCONF_S size 0x1000 — PCGCSlave 2
0x50105000 PPIMATRIX_MCU_S size 0x1000 — PCGCSlave 3
0x50106000 WAKEUPPDTIMERS_S size 0x1000 — PCGCSlave 4
0x50107000 POWERSWITCH_SLAVE_S size 0x1000 — PCGCSlave 5
0x50108000 PCGCSLAVE_RAMBISTHUB_S size 0x1000 — PCGCSlave 6
0x50109000 PCGCSLAVE_AMLI_S size 0x1000 — PCGCSlave 7
0x5010A000 PCGCSLAVE_RESETHANDLER_S size 0x1000 — PCGCSlave 8
0x5010B000 PCGCSLAVE_APPMAIN_S size 0x1000 — PCGCSlave 9
0x50200000 APBWUP_TIMER_S size 0x1000 — PCGCSlave 10
0x50201000 PCGCMASTER_PERMCU_S size 0x1000 — PCGC Master 3
0x50202000 PCGCMASTER_PERMAIN_S size 0x1000 — PCGC Master 4
0x50203000 PCGCMASTER_TIMERS_S size 0x1000 — PCGC Master 5
0x50204000 PPIMATRIX_TIMERS_S size 0x1000 — PCGCSlave 11
0x50205000 PPIMATRIX_PERIPHERALS_S size 0x1000 — PCGCSlave 12
0x50206000 PPIMATRIX_IPC_S size 0x1000 — PCGCSlave 13
0x50207000 APBWUP_IPC_S size 0x1000 — PCGCSlave 14
0x50300000 PCGCMASTER_PAC_S size 0x1000 — PCGC Master 6
0x508C0500 P0_S size 0x300 — GPIO Port 2
0x508C0800 P1_S size 0x300 — GPIO Port 3
0x508C1000 CRYPTOCELL_S size 0x2000 — ARM TrustZone CryptoCell register interface
0xE0080000 TAD_S size 0x1000 — Trace and debug control

## Interrupts
0 DCNF (DCNF_NS, DCNF_S)
3 SPU (SPU_S)
5 POWER_CLOCK (CLOCK_NS, POWER_NS, CLOCK_S, POWER_S)
8 UARTE0_SPIM0_SPIS0_TWIM0_TWIS0 (SPIM0_NS, SPIS0_NS, TWIM0_NS, TWIS0_NS, UARTE0_NS, SPIM0_S, SPIS0_S, TWIM0_S, TWIS0_S, UARTE0_S)
9 UARTE1_SPIM1_SPIS1_TWIM1_TWIS1 (SPIM1_NS, SPIS1_NS, TWIM1_NS, TWIS1_NS, UARTE1_NS, SPIM1_S, SPIS1_S, TWIM1_S, TWIS1_S, UARTE1_S)
10 SPIM2 (SPIM2_NS, SPIM2_S)
13 GPIOTE_S (GPIOTE_S_S)
14 SAADC (SAADC_NS, SAADC_S)
15 TIMER0 (TIMER0_NS, TIMER0_S)
16 TIMER1 (TIMER1_NS, TIMER1_S)
17 TIMER2 (TIMER2_NS, TIMER2_S)
20 RTC0 (RTC0_NS, RTC0_S)
21 RTC1 (RTC1_NS, RTC1_S)
24 WDT0 (WDT0_NS, WDT0_S)
25 WDT1 (WDT1_NS, WDT1_S)
26 COMP_LPCOMP (COMP_NS, LPCOMP_NS, COMP_S, LPCOMP_S)
27 EGU0 (EGU0_NS, EGU0_S)
28 EGU1 (EGU1_NS, EGU1_S)
29 EGU2 (EGU2_NS, EGU2_S)
30 EGU3 (EGU3_NS, EGU3_S)
31 EGU4 (EGU4_NS, EGU4_S)
32 EGU5 (EGU5_NS, EGU5_S)
33 PWM0 (PWM0_NS, PWM0_S)
34 PWM1 (PWM1_NS, PWM1_S)
35 PWM2 (PWM2_NS, PWM2_S)
38 PDM0 (PDM0_NS, PDM0_S)
40 I2S0 (I2S0_NS, I2S0_S)
42 IPC (IPC_NS, IPC_S)
43 QSPI (QSPI_NS, QSPI_S)
45 NFCT (NFCT_NS, NFCT_S)
46 M2M (M2M_NS, M2M_S)
49 GPIOTE_NS (GPIOTE_NS_NS)
128 KMU (KMU_S)
193 CRYPTOCELL (CRYPTOCELL_S)

## Further device data
MaxInterrupts=240

## Licence text in the file
Copyright (c) 2010 - 2018, Nordic Semiconductor ASA . All rights reserved. . Redistribution and use in source and binary forms, with or without modification, are permitted provided that the following conditions are met: . 1. Redistributions of source code must retain the above copyright notice, this list of conditions and the following disclaimer. . 2. Redistributions in binary form, except as embedded into a Nordic. Semiconductor ASA integrated circuit in a product or a software update for such product, must reproduce the above copyright notice, this list of conditions and the following disclaimer in the documentation and/or other materials provided with the distribution. . 3. Neither the name of Nordic Semiconductor ASA nor the names of its contributors may be used to endorse or promote products derived from this software without specific prior written permission. . 4. This software, with or without modification, must only be used with a. Nordic Semiconductor ASA integrated circuit. . 5. Any software provided in binary form under this license must not be reverse engineered, decompiled, modified and/or disassembled. . THIS SOFTWARE IS PROVIDED BY NORDIC SEMICONDUCTOR ASA "AS IS" AND ANY EXPRESS. OR IMPLIED WARRANTIES, INCLUDING, BUT NOT LIMITED TO, THE IMPLIED WARRANTIES. OF MERCHANTABILITY, NONINFRINGEMENT, AND FITNESS FOR A PARTICULAR PURPOSE ARE. DISCLAIMED. IN NO EVENT SHALL NORDIC SEMICONDUCTOR ASA OR CONTRIBUTORS BE. LIABLE FOR ANY DIRECT, INDIRECT, INCIDENTAL, SPECIAL, EXEMPLARY, OR. CONSEQUENTIAL DAMAGES (INCLUDING, BUT NOT LIMITED TO, PROCUREMENT OF SUBSTITUTE. GOODS OR SERVICES; LOSS OF USE, DATA, OR PROFITS; OR BUSINESS INTERRUPTION). HOWEVER CAUSED AND ON ANY THEORY OF LIABILITY, WHETHER IN CONTRACT, STRICT. LIABILITY, OR TORT (INCLUDING NEGLIGENCE OR OTHERWISE) ARISING IN ANY WAY OUT. OF THE USE OF THIS SOFTWARE, EVEN IF ADVISED OF THE POSSIBILITY OF SUCH DAMAGE.
